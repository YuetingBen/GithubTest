/*MMMMMMMMMMMMNNNNNMMMMMMMMMMMMMMMMMMMMMMMMMMMNNNNNMMMMMMMMMMMMMMMMMMMMMMMMMMMNNNNNNMMMMMMMMMMMMM*/
/*M+NMMMNdyso+////++oyhmNMMMMMMMMMMMMMMMNmhso++////+oshmNMMMMMMMMMMMMMMMNmhyo++////+osydNNNNMNNNM*/
/*M+NMMd///+osyyyyss+///+smNMMMMMMMMMNds+///osyyyyyso////sdNMMMMMMMMMNmy+///+osyyyyso+///ohNNNNNM*/
/*M+NNMdohmNNMNNNNNNNNdy+//odNMMMMNNh+//+ymNNNNNNNNNNNmy+//+hNNNNNNNdo//+sdNNNNNNNNNNNmho//+yNNNM*/
/*M+NNNNNNNmhysooosydNNNNh+//yNNNNms//+dNNNNdysooosydNNNNdo//omNNNNy//+hNNNNdysooooyhmNNNms//+dNM*/
/*M+NNNNNdo//////////+ymNNmo//smmdo//sNNNms///////////sdmmdo//+dmms//omNNNy+//////////odmmms//+dM*/
/*M+mNNNy//////////////+mNNm+///////oNNNd+//////////////////////////+mNNm+/////////////////////oM*/
/*M+mNNd////////////////sNNNmdddhhhhmNNm+////////////////hhhhhhhhhhhdNNNmhhhhhhhhhhhhhhhhhhhh///M*/
/*M+mNNd////////////////oNNNNNNNNNNNNNNm+////////////////dNNNNNNNNNNNNNNNNNNNNNNNNNNNNNNNNNNm+//M*/
/*M/hNNmo///////////////hNNNs///////yNNNy///////////////////////////////////////////////omNNh//+M*/
/*M/+dNNms////////////+hNNNy//+sss///hNNmy/////////////ssss+///sss+///ssss+////////////smNNd+//yM*/
/*M//+hmNNmyo+/////+shmNNms//+dNNNh+//ymNNmho+/////+ohmNNmy///hNNNd+//odNNmhs+//////oymNNmh+//ymM*/
/*Mh+//+ymNNNmmmdmmNNNmds///smNNNNNdo//+ydmNNNmmdmmmNNmdy+//odNNNNNms///sdmNNNmmdmmmNNNmy+//+hmNM*/
/*Mmmho///+syhdddddhyo+///sdmNNNNNNNmho///+syhdddddhys+///ohmNNNNNNNNds+//+oyhdddddhys+///ohmNNNM*/
/*Mmmmmdyo+///////////oshmmmNmmmmmmNNmmmhs+///////////+shmmNNNNNNNNNNNNmhso///////////+oydmNNmmmM*/
/*MmmmmmmmmmdhyyyyhddmmmmmmmmmmmmmmmmmmmmmmmddhyyyhddmmmmmmmmmmmmmmmmmmmmmmmddhyyyyhdmmmmmmmmmmmM*/
/*MMMMMMMMMMMMNNNNNMMMMMMMMMMMMMMMMMMMMMMMMMMMNNNNNMMMMMMMMMMMMMMMMMMMMMMMMMMMNNNNNNMMMMMMMMMMMMM*

  filename:     ESCL.can
  
  description:  Brief: ESCL
                Generation date: 14/08/2020 17:38:42
                DBC File: CAN_Matrix_ESCL_20200814.dbc
                User Name: BenY
                
  ATTENTIONS:   This file code generated by Tool automatically, don't modify this 
                file manually.  
 ----------------------------------------------------------------------------- */
/* -----------------------------------------------------------------------------
  C O P Y R I G H T
 -------------------------------------------------------------------------------
  Copyright (c) 2019 by Yueting Ben. All rights reserved.
 -------------------------------------------------------------------------------
/**************************************************************************************************/
 variables
{
  message Msg_ESCL_NM Msg_ESCL_NM_Frame;
  message ESCL_276 ESCL_276_Frame;
  msTimer Msg_ESCL_NM_Timer;
  msTimer ESCL_276_Timer;
  byte Msg_ESCL_NM_EnableFlag;
  byte ESCL_276_EnableFlag;
}
on start
{
  setTimer(Msg_ESCL_NM_Timer, 0);
  setTimer(ESCL_276_Timer, 0);
  Msg_ESCL_NM_EnableFlag = @sysvar::MESSAGEFRAME::Msg_ESCL_NMMessageEnable & @sysvar::NODE::ESCLEnableAll_Msg;
  ESCL_276_EnableFlag = @sysvar::MESSAGEFRAME::ESCL_276MessageEnable & @sysvar::NODE::ESCLEnableAll_Msg;
}

/**************************************************************************************************/
/*
  brief:        Send Msg_ESCL_NM in cycle
  
  author:       Generation tool
*/
/**************************************************************************************************/
 on Timer Msg_ESCL_NM_Timer
{
  if(1 == Msg_ESCL_NM_EnableFlag)
  {
    output(Msg_ESCL_NM_Frame);
  }
  Msg_ESCL_NM_Frame.ESCL_NotSleep_sleep_ack = @sysvar::SIGNALINFO::ESCL_NotSleep_sleep_ackValue;
  Msg_ESCL_NM_Frame.ESCL_NotSleep_IGN_status = @sysvar::SIGNALINFO::ESCL_NotSleep_IGN_statusValue;
  Msg_ESCL_NM_Frame.ESCL_NotSleep_HW_Speed = @sysvar::SIGNALINFO::ESCL_NotSleep_HW_SpeedValue;
  Msg_ESCL_NM_Frame.ESCL_NotSleep_CAN_Message = @sysvar::SIGNALINFO::ESCL_NotSleep_CAN_MessageValue;
  Msg_ESCL_NM_Frame.ESCL_NotSleep_CAN_Speed = @sysvar::SIGNALINFO::ESCL_NotSleep_CAN_SpeedValue;
  Msg_ESCL_NM_Frame.ESCL_WakeUp_IGN_status = @sysvar::SIGNALINFO::ESCL_WakeUp_IGN_statusValue;
  Msg_ESCL_NM_Frame.ESCL_WakeUp_CAN_Message = @sysvar::SIGNALINFO::ESCL_WakeUp_CAN_MessageValue;
  Msg_ESCL_NM_Frame.ESCL_NM_LimpHome = @sysvar::SIGNALINFO::ESCL_NM_LimpHomeValue;
  Msg_ESCL_NM_Frame.ESCL_NM_Ring = @sysvar::SIGNALINFO::ESCL_NM_RingValue;
  Msg_ESCL_NM_Frame.ESCL_NM_Sleep_Ack = @sysvar::SIGNALINFO::ESCL_NM_Sleep_AckValue;
  Msg_ESCL_NM_Frame.ESCL_NM_Sleep_Ind = @sysvar::SIGNALINFO::ESCL_NM_Sleep_IndValue;
  Msg_ESCL_NM_Frame.ESCL_NM_Destination_ID = @sysvar::SIGNALINFO::ESCL_NM_Destination_IDValue;
  Msg_ESCL_NM_Frame.ESCL_NM_Alive = @sysvar::SIGNALINFO::ESCL_NM_AliveValue;
  setTimer(Msg_ESCL_NM_Timer, 500);
}

/**************************************************************************************************/
/*
  brief:        Send ESCL_276 in cycle
  
  author:       Generation tool
*/
/**************************************************************************************************/
 on Timer ESCL_276_Timer
{
  if(1 == ESCL_276_EnableFlag)
  {
    output(ESCL_276_Frame);
  }
  ESCL_276_Frame.ESCL_SteeringLockError = @sysvar::SIGNALINFO::ESCL_SteeringLockErrorValue;
  ESCL_276_Frame.ESCL_SteeringLockStatusReserve = @sysvar::SIGNALINFO::ESCL_SteeringLockStatusReserveValue;
  ESCL_276_Frame.ESCL_SteeringLockStuck = @sysvar::SIGNALINFO::ESCL_SteeringLockStuckValue;
  ESCL_276_Frame.ESCL_SteeringLockWait = @sysvar::SIGNALINFO::ESCL_SteeringLockWaitValue;
  ESCL_276_Frame.ESCL_SteeringLockStatus_S301 = @sysvar::SIGNALINFO::ESCL_SteeringLockStatus_S301Value;
  setTimer(ESCL_276_Timer, 40);
}

/**************************************************************************************************/
/*
  brief:        Check the CheckBox ESCL_EnableAll_Msg
  
  author:       Generation tool
*/
/**************************************************************************************************/
 on sysvar NODE::ESCLEnableAll_Msg
{
  if(1 == @sysvar::NODE::ESCLEnableAll_Msg)
  {
    @sysvar::NODE::ESCLEnableAll_Msg = 1;
    @sysvar::NODE::ESCLDisableAll_Msg = 0;
    @sysvar::MESSAGEFRAME::Msg_ESCL_NMMessageEnable = 1;
    Msg_ESCL_NM_EnableFlag = @sysvar::MESSAGEFRAME::Msg_ESCL_NMMessageEnable & @sysvar::NODE::ESCLEnableAll_Msg;
    @sysvar::MESSAGEFRAME::ESCL_276MessageEnable = 1;
    ESCL_276_EnableFlag = @sysvar::MESSAGEFRAME::ESCL_276MessageEnable & @sysvar::NODE::ESCLEnableAll_Msg;
  }
  else
  {
    @sysvar::NODE::ESCLEnableAll_Msg = 0;
    @sysvar::NODE::ESCLDisableAll_Msg = 1;
    @sysvar::MESSAGEFRAME::Msg_ESCL_NMMessageEnable = 0;
    Msg_ESCL_NM_EnableFlag = @sysvar::MESSAGEFRAME::Msg_ESCL_NMMessageEnable & @sysvar::NODE::ESCLEnableAll_Msg;
    @sysvar::MESSAGEFRAME::ESCL_276MessageEnable = 0;
    ESCL_276_EnableFlag = @sysvar::MESSAGEFRAME::ESCL_276MessageEnable & @sysvar::NODE::ESCLEnableAll_Msg;
  }
}

/**************************************************************************************************/
/*
  brief:        Check the CheckBox ESCL_DisableAll_Msg
  
  author:       Generation tool
*/
/**************************************************************************************************/
 on sysvar NODE::ESCLDisableAll_Msg
{
  if(1 == @sysvar::NODE::ESCLDisableAll_Msg)
  {
    @sysvar::NODE::ESCLEnableAll_Msg = 0;
    @sysvar::NODE::ESCLDisableAll_Msg = 1;
    @sysvar::MESSAGEFRAME::Msg_ESCL_NMMessageEnable = 0;
    Msg_ESCL_NM_EnableFlag = @sysvar::MESSAGEFRAME::Msg_ESCL_NMMessageEnable & @sysvar::NODE::ESCLEnableAll_Msg;
    @sysvar::MESSAGEFRAME::ESCL_276MessageEnable = 0;
    ESCL_276_EnableFlag = @sysvar::MESSAGEFRAME::ESCL_276MessageEnable & @sysvar::NODE::ESCLEnableAll_Msg;
  }
  else
  {
    @sysvar::NODE::ESCLEnableAll_Msg = 1;
    @sysvar::NODE::ESCLDisableAll_Msg = 0;
    @sysvar::MESSAGEFRAME::Msg_ESCL_NMMessageEnable = 1;
    Msg_ESCL_NM_EnableFlag = @sysvar::MESSAGEFRAME::Msg_ESCL_NMMessageEnable & @sysvar::NODE::ESCLEnableAll_Msg;
    @sysvar::MESSAGEFRAME::ESCL_276MessageEnable = 1;
    ESCL_276_EnableFlag = @sysvar::MESSAGEFRAME::ESCL_276MessageEnable & @sysvar::NODE::ESCLEnableAll_Msg;
  }
}

/**************************************************************************************************/
/*
  brief:        Check the CheckBox Msg_ESCL_NM MessageEnable
  
  author:       Generation tool
*/
/**************************************************************************************************/
 on sysvar MESSAGEFRAME::Msg_ESCL_NMMessageEnable
{
  Msg_ESCL_NM_EnableFlag = @sysvar::MESSAGEFRAME::Msg_ESCL_NMMessageEnable & @sysvar::NODE::ESCLEnableAll_Msg;
}

/**************************************************************************************************/
/*
  brief:        Check the CheckBox ESCL_276 MessageEnable
  
  author:       Generation tool
*/
/**************************************************************************************************/
 on sysvar MESSAGEFRAME::ESCL_276MessageEnable
{
  ESCL_276_EnableFlag = @sysvar::MESSAGEFRAME::ESCL_276MessageEnable & @sysvar::NODE::ESCLEnableAll_Msg;
}

