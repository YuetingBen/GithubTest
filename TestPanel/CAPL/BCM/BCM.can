/*MMMMMMMMMMMMNNNNNMMMMMMMMMMMMMMMMMMMMMMMMMMMNNNNNMMMMMMMMMMMMMMMMMMMMMMMMMMMNNNNNNMMMMMMMMMMMMM*/
/*M+NMMMNdyso+////++oyhmNMMMMMMMMMMMMMMMNmhso++////+oshmNMMMMMMMMMMMMMMMNmhyo++////+osydNNNNMNNNM*/
/*M+NMMd///+osyyyyss+///+smNMMMMMMMMMNds+///osyyyyyso////sdNMMMMMMMMMNmy+///+osyyyyso+///ohNNNNNM*/
/*M+NNMdohmNNMNNNNNNNNdy+//odNMMMMNNh+//+ymNNNNNNNNNNNmy+//+hNNNNNNNdo//+sdNNNNNNNNNNNmho//+yNNNM*/
/*M+NNNNNNNmhysooosydNNNNh+//yNNNNms//+dNNNNdysooosydNNNNdo//omNNNNy//+hNNNNdysooooyhmNNNms//+dNM*/
/*M+NNNNNdo//////////+ymNNmo//smmdo//sNNNms///////////sdmmdo//+dmms//omNNNy+//////////odmmms//+dM*/
/*M+mNNNy//////////////+mNNm+///////oNNNd+//////////////////////////+mNNm+/////////////////////oM*/
/*M+mNNd////////////////sNNNmdddhhhhmNNm+////////////////hhhhhhhhhhhdNNNmhhhhhhhhhhhhhhhhhhhh///M*/
/*M+mNNd////////////////oNNNNNNNNNNNNNNm+////////////////dNNNNNNNNNNNNNNNNNNNNNNNNNNNNNNNNNNm+//M*/
/*M/hNNmo///////////////hNNNs///////yNNNy///////////////////////////////////////////////omNNh//+M*/
/*M/+dNNms////////////+hNNNy//+sss///hNNmy/////////////ssss+///sss+///ssss+////////////smNNd+//yM*/
/*M//+hmNNmyo+/////+shmNNms//+dNNNh+//ymNNmho+/////+ohmNNmy///hNNNd+//odNNmhs+//////oymNNmh+//ymM*/
/*Mh+//+ymNNNmmmdmmNNNmds///smNNNNNdo//+ydmNNNmmdmmmNNmdy+//odNNNNNms///sdmNNNmmdmmmNNNmy+//+hmNM*/
/*Mmmho///+syhdddddhyo+///sdmNNNNNNNmho///+syhdddddhys+///ohmNNNNNNNNds+//+oyhdddddhys+///ohmNNNM*/
/*Mmmmmdyo+///////////oshmmmNmmmmmmNNmmmhs+///////////+shmmNNNNNNNNNNNNmhso///////////+oydmNNmmmM*/
/*MmmmmmmmmmdhyyyyhddmmmmmmmmmmmmmmmmmmmmmmmddhyyyhddmmmmmmmmmmmmmmmmmmmmmmmddhyyyyhdmmmmmmmmmmmM*/
/*MMMMMMMMMMMMNNNNNMMMMMMMMMMMMMMMMMMMMMMMMMMMNNNNNMMMMMMMMMMMMMMMMMMMMMMMMMMMNNNNNNMMMMMMMMMMMMM*

  filename:     BCM.can
  
  description:  Brief: BCM
                Generation date: 14/08/2020 17:38:42
                DBC File: CAN_Matrix_ESCL_20200814.dbc
                User Name: BenY
                
  ATTENTIONS:   This file code generated by Tool automatically, don't modify this 
                file manually.  
 ----------------------------------------------------------------------------- */
/* -----------------------------------------------------------------------------
  C O P Y R I G H T
 -------------------------------------------------------------------------------
  Copyright (c) 2019 by Yueting Ben. All rights reserved.
 -------------------------------------------------------------------------------
/**************************************************************************************************/
 variables
{
  message BCM_266 BCM_266_Frame;
  message Msg_BCM_NM Msg_BCM_NM_Frame;
  message BCM_288 BCM_288_Frame;
  msTimer BCM_266_Timer;
  msTimer Msg_BCM_NM_Timer;
  msTimer BCM_288_Timer;
  byte BCM_266_EnableFlag;
  byte Msg_BCM_NM_EnableFlag;
  byte BCM_288_EnableFlag;
}
on start
{
  setTimer(BCM_266_Timer, 0);
  setTimer(Msg_BCM_NM_Timer, 0);
  setTimer(BCM_288_Timer, 0);
  BCM_266_EnableFlag = @sysvar::MESSAGEFRAME::BCM_266MessageEnable & @sysvar::NODE::BCMEnableAll_Msg;
  Msg_BCM_NM_EnableFlag = @sysvar::MESSAGEFRAME::Msg_BCM_NMMessageEnable & @sysvar::NODE::BCMEnableAll_Msg;
  BCM_288_EnableFlag = @sysvar::MESSAGEFRAME::BCM_288MessageEnable & @sysvar::NODE::BCMEnableAll_Msg;
}

/**************************************************************************************************/
/*
  brief:        Send BCM_266 in cycle
  
  author:       Generation tool
*/
/**************************************************************************************************/
 on Timer BCM_266_Timer
{
  if(1 == BCM_266_EnableFlag)
  {
    output(BCM_266_Frame);
  }
  BCM_266_Frame.PEPS_UnlockSignal = @sysvar::SIGNALINFO::PEPS_UnlockSignalValue;
  BCM_266_Frame.PEPS_PowerDistributionStatus = @sysvar::SIGNALINFO::PEPS_PowerDistributionStatusValue;
  BCM_266_Frame.PEPS_LockSignal = @sysvar::SIGNALINFO::PEPS_LockSignalValue;
  setTimer(BCM_266_Timer, 40);
}

/**************************************************************************************************/
/*
  brief:        Send Msg_BCM_NM in cycle
  
  author:       Generation tool
*/
/**************************************************************************************************/
 on Timer Msg_BCM_NM_Timer
{
  if(1 == Msg_BCM_NM_EnableFlag)
  {
    output(Msg_BCM_NM_Frame);
  }
  setTimer(Msg_BCM_NM_Timer, 500);
}

/**************************************************************************************************/
/*
  brief:        Send BCM_288 in cycle
  
  author:       Generation tool
*/
/**************************************************************************************************/
 on Timer BCM_288_Timer
{
  if(1 == BCM_288_EnableFlag)
  {
    output(BCM_288_Frame);
  }
  BCM_288_Frame.BCM_DriverDoorStatus = @sysvar::SIGNALINFO::BCM_DriverDoorStatusValue;
  setTimer(BCM_288_Timer, 40);
}

/**************************************************************************************************/
/*
  brief:        Check the CheckBox BCM_EnableAll_Msg
  
  author:       Generation tool
*/
/**************************************************************************************************/
 on sysvar NODE::BCMEnableAll_Msg
{
  if(1 == @sysvar::NODE::BCMEnableAll_Msg)
  {
    @sysvar::NODE::BCMEnableAll_Msg = 1;
    @sysvar::NODE::BCMDisableAll_Msg = 0;
    @sysvar::MESSAGEFRAME::BCM_266MessageEnable = 1;
    BCM_266_EnableFlag = @sysvar::MESSAGEFRAME::BCM_266MessageEnable & @sysvar::NODE::BCMEnableAll_Msg;
    @sysvar::MESSAGEFRAME::Msg_BCM_NMMessageEnable = 1;
    Msg_BCM_NM_EnableFlag = @sysvar::MESSAGEFRAME::Msg_BCM_NMMessageEnable & @sysvar::NODE::BCMEnableAll_Msg;
    @sysvar::MESSAGEFRAME::BCM_288MessageEnable = 1;
    BCM_288_EnableFlag = @sysvar::MESSAGEFRAME::BCM_288MessageEnable & @sysvar::NODE::BCMEnableAll_Msg;
  }
  else
  {
    @sysvar::NODE::BCMEnableAll_Msg = 0;
    @sysvar::NODE::BCMDisableAll_Msg = 1;
    @sysvar::MESSAGEFRAME::BCM_266MessageEnable = 0;
    BCM_266_EnableFlag = @sysvar::MESSAGEFRAME::BCM_266MessageEnable & @sysvar::NODE::BCMEnableAll_Msg;
    @sysvar::MESSAGEFRAME::Msg_BCM_NMMessageEnable = 0;
    Msg_BCM_NM_EnableFlag = @sysvar::MESSAGEFRAME::Msg_BCM_NMMessageEnable & @sysvar::NODE::BCMEnableAll_Msg;
    @sysvar::MESSAGEFRAME::BCM_288MessageEnable = 0;
    BCM_288_EnableFlag = @sysvar::MESSAGEFRAME::BCM_288MessageEnable & @sysvar::NODE::BCMEnableAll_Msg;
  }
}

/**************************************************************************************************/
/*
  brief:        Check the CheckBox BCM_DisableAll_Msg
  
  author:       Generation tool
*/
/**************************************************************************************************/
 on sysvar NODE::BCMDisableAll_Msg
{
  if(1 == @sysvar::NODE::BCMDisableAll_Msg)
  {
    @sysvar::NODE::BCMEnableAll_Msg = 0;
    @sysvar::NODE::BCMDisableAll_Msg = 1;
    @sysvar::MESSAGEFRAME::BCM_266MessageEnable = 0;
    BCM_266_EnableFlag = @sysvar::MESSAGEFRAME::BCM_266MessageEnable & @sysvar::NODE::BCMEnableAll_Msg;
    @sysvar::MESSAGEFRAME::Msg_BCM_NMMessageEnable = 0;
    Msg_BCM_NM_EnableFlag = @sysvar::MESSAGEFRAME::Msg_BCM_NMMessageEnable & @sysvar::NODE::BCMEnableAll_Msg;
    @sysvar::MESSAGEFRAME::BCM_288MessageEnable = 0;
    BCM_288_EnableFlag = @sysvar::MESSAGEFRAME::BCM_288MessageEnable & @sysvar::NODE::BCMEnableAll_Msg;
  }
  else
  {
    @sysvar::NODE::BCMEnableAll_Msg = 1;
    @sysvar::NODE::BCMDisableAll_Msg = 0;
    @sysvar::MESSAGEFRAME::BCM_266MessageEnable = 1;
    BCM_266_EnableFlag = @sysvar::MESSAGEFRAME::BCM_266MessageEnable & @sysvar::NODE::BCMEnableAll_Msg;
    @sysvar::MESSAGEFRAME::Msg_BCM_NMMessageEnable = 1;
    Msg_BCM_NM_EnableFlag = @sysvar::MESSAGEFRAME::Msg_BCM_NMMessageEnable & @sysvar::NODE::BCMEnableAll_Msg;
    @sysvar::MESSAGEFRAME::BCM_288MessageEnable = 1;
    BCM_288_EnableFlag = @sysvar::MESSAGEFRAME::BCM_288MessageEnable & @sysvar::NODE::BCMEnableAll_Msg;
  }
}

/**************************************************************************************************/
/*
  brief:        Check the CheckBox BCM_266 MessageEnable
  
  author:       Generation tool
*/
/**************************************************************************************************/
 on sysvar MESSAGEFRAME::BCM_266MessageEnable
{
  BCM_266_EnableFlag = @sysvar::MESSAGEFRAME::BCM_266MessageEnable & @sysvar::NODE::BCMEnableAll_Msg;
}

/**************************************************************************************************/
/*
  brief:        Check the CheckBox Msg_BCM_NM MessageEnable
  
  author:       Generation tool
*/
/**************************************************************************************************/
 on sysvar MESSAGEFRAME::Msg_BCM_NMMessageEnable
{
  Msg_BCM_NM_EnableFlag = @sysvar::MESSAGEFRAME::Msg_BCM_NMMessageEnable & @sysvar::NODE::BCMEnableAll_Msg;
}

/**************************************************************************************************/
/*
  brief:        Check the CheckBox BCM_288 MessageEnable
  
  author:       Generation tool
*/
/**************************************************************************************************/
 on sysvar MESSAGEFRAME::BCM_288MessageEnable
{
  BCM_288_EnableFlag = @sysvar::MESSAGEFRAME::BCM_288MessageEnable & @sysvar::NODE::BCMEnableAll_Msg;
}

