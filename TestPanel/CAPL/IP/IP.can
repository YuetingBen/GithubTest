/*MMMMMMMMMMMMNNNNNMMMMMMMMMMMMMMMMMMMMMMMMMMMNNNNNMMMMMMMMMMMMMMMMMMMMMMMMMMMNNNNNNMMMMMMMMMMMMM*/
/*M+NMMMNdyso+////++oyhmNMMMMMMMMMMMMMMMNmhso++////+oshmNMMMMMMMMMMMMMMMNmhyo++////+osydNNNNMNNNM*/
/*M+NMMd///+osyyyyss+///+smNMMMMMMMMMNds+///osyyyyyso////sdNMMMMMMMMMNmy+///+osyyyyso+///ohNNNNNM*/
/*M+NNMdohmNNMNNNNNNNNdy+//odNMMMMNNh+//+ymNNNNNNNNNNNmy+//+hNNNNNNNdo//+sdNNNNNNNNNNNmho//+yNNNM*/
/*M+NNNNNNNmhysooosydNNNNh+//yNNNNms//+dNNNNdysooosydNNNNdo//omNNNNy//+hNNNNdysooooyhmNNNms//+dNM*/
/*M+NNNNNdo//////////+ymNNmo//smmdo//sNNNms///////////sdmmdo//+dmms//omNNNy+//////////odmmms//+dM*/
/*M+mNNNy//////////////+mNNm+///////oNNNd+//////////////////////////+mNNm+/////////////////////oM*/
/*M+mNNd////////////////sNNNmdddhhhhmNNm+////////////////hhhhhhhhhhhdNNNmhhhhhhhhhhhhhhhhhhhh///M*/
/*M+mNNd////////////////oNNNNNNNNNNNNNNm+////////////////dNNNNNNNNNNNNNNNNNNNNNNNNNNNNNNNNNNm+//M*/
/*M/hNNmo///////////////hNNNs///////yNNNy///////////////////////////////////////////////omNNh//+M*/
/*M/+dNNms////////////+hNNNy//+sss///hNNmy/////////////ssss+///sss+///ssss+////////////smNNd+//yM*/
/*M//+hmNNmyo+/////+shmNNms//+dNNNh+//ymNNmho+/////+ohmNNmy///hNNNd+//odNNmhs+//////oymNNmh+//ymM*/
/*Mh+//+ymNNNmmmdmmNNNmds///smNNNNNdo//+ydmNNNmmdmmmNNmdy+//odNNNNNms///sdmNNNmmdmmmNNNmy+//+hmNM*/
/*Mmmho///+syhdddddhyo+///sdmNNNNNNNmho///+syhdddddhys+///ohmNNNNNNNNds+//+oyhdddddhys+///ohmNNNM*/
/*Mmmmmdyo+///////////oshmmmNmmmmmmNNmmmhs+///////////+shmmNNNNNNNNNNNNmhso///////////+oydmNNmmmM*/
/*MmmmmmmmmmdhyyyyhddmmmmmmmmmmmmmmmmmmmmmmmddhyyyhddmmmmmmmmmmmmmmmmmmmmmmmddhyyyyhdmmmmmmmmmmmM*/
/*MMMMMMMMMMMMNNNNNMMMMMMMMMMMMMMMMMMMMMMMMMMMNNNNNMMMMMMMMMMMMMMMMMMMMMMMMMMMNNNNNNMMMMMMMMMMMMM*

  filename:     IP.can
  
  description:  Brief: IP
                Generation date: 14/08/2020 17:38:42
                DBC File: CAN_Matrix_ESCL_20200814.dbc
                User Name: BenY
                
  ATTENTIONS:   This file code generated by Tool automatically, don't modify this 
                file manually.  
 ----------------------------------------------------------------------------- */
/* -----------------------------------------------------------------------------
  C O P Y R I G H T
 -------------------------------------------------------------------------------
  Copyright (c) 2019 by Yueting Ben. All rights reserved.
 -------------------------------------------------------------------------------
/**************************************************************************************************/
 variables
{
  message IP_380 IP_380_Frame;
  message Msg_IP_NM Msg_IP_NM_Frame;
  msTimer IP_380_Timer;
  msTimer Msg_IP_NM_Timer;
  byte IP_380_EnableFlag;
  byte Msg_IP_NM_EnableFlag;
}
on start
{
  setTimer(IP_380_Timer, 0);
  setTimer(Msg_IP_NM_Timer, 0);
  IP_380_EnableFlag = @sysvar::MESSAGEFRAME::IP_380MessageEnable & @sysvar::NODE::IPEnableAll_Msg;
  Msg_IP_NM_EnableFlag = @sysvar::MESSAGEFRAME::Msg_IP_NMMessageEnable & @sysvar::NODE::IPEnableAll_Msg;
}

/**************************************************************************************************/
/*
  brief:        Send IP_380 in cycle
  
  author:       Generation tool
*/
/**************************************************************************************************/
 on Timer IP_380_Timer
{
  if(1 == IP_380_EnableFlag)
  {
    output(IP_380_Frame);
  }
  setTimer(IP_380_Timer, 500);
}

/**************************************************************************************************/
/*
  brief:        Send Msg_IP_NM in cycle
  
  author:       Generation tool
*/
/**************************************************************************************************/
 on Timer Msg_IP_NM_Timer
{
  if(1 == Msg_IP_NM_EnableFlag)
  {
    output(Msg_IP_NM_Frame);
  }
  setTimer(Msg_IP_NM_Timer, 500);
}

/**************************************************************************************************/
/*
  brief:        Check the CheckBox IP_EnableAll_Msg
  
  author:       Generation tool
*/
/**************************************************************************************************/
 on sysvar NODE::IPEnableAll_Msg
{
  if(1 == @sysvar::NODE::IPEnableAll_Msg)
  {
    @sysvar::NODE::IPEnableAll_Msg = 1;
    @sysvar::NODE::IPDisableAll_Msg = 0;
    @sysvar::MESSAGEFRAME::IP_380MessageEnable = 1;
    IP_380_EnableFlag = @sysvar::MESSAGEFRAME::IP_380MessageEnable & @sysvar::NODE::IPEnableAll_Msg;
    @sysvar::MESSAGEFRAME::Msg_IP_NMMessageEnable = 1;
    Msg_IP_NM_EnableFlag = @sysvar::MESSAGEFRAME::Msg_IP_NMMessageEnable & @sysvar::NODE::IPEnableAll_Msg;
  }
  else
  {
    @sysvar::NODE::IPEnableAll_Msg = 0;
    @sysvar::NODE::IPDisableAll_Msg = 1;
    @sysvar::MESSAGEFRAME::IP_380MessageEnable = 0;
    IP_380_EnableFlag = @sysvar::MESSAGEFRAME::IP_380MessageEnable & @sysvar::NODE::IPEnableAll_Msg;
    @sysvar::MESSAGEFRAME::Msg_IP_NMMessageEnable = 0;
    Msg_IP_NM_EnableFlag = @sysvar::MESSAGEFRAME::Msg_IP_NMMessageEnable & @sysvar::NODE::IPEnableAll_Msg;
  }
}

/**************************************************************************************************/
/*
  brief:        Check the CheckBox IP_DisableAll_Msg
  
  author:       Generation tool
*/
/**************************************************************************************************/
 on sysvar NODE::IPDisableAll_Msg
{
  if(1 == @sysvar::NODE::IPDisableAll_Msg)
  {
    @sysvar::NODE::IPEnableAll_Msg = 0;
    @sysvar::NODE::IPDisableAll_Msg = 1;
    @sysvar::MESSAGEFRAME::IP_380MessageEnable = 0;
    IP_380_EnableFlag = @sysvar::MESSAGEFRAME::IP_380MessageEnable & @sysvar::NODE::IPEnableAll_Msg;
    @sysvar::MESSAGEFRAME::Msg_IP_NMMessageEnable = 0;
    Msg_IP_NM_EnableFlag = @sysvar::MESSAGEFRAME::Msg_IP_NMMessageEnable & @sysvar::NODE::IPEnableAll_Msg;
  }
  else
  {
    @sysvar::NODE::IPEnableAll_Msg = 1;
    @sysvar::NODE::IPDisableAll_Msg = 0;
    @sysvar::MESSAGEFRAME::IP_380MessageEnable = 1;
    IP_380_EnableFlag = @sysvar::MESSAGEFRAME::IP_380MessageEnable & @sysvar::NODE::IPEnableAll_Msg;
    @sysvar::MESSAGEFRAME::Msg_IP_NMMessageEnable = 1;
    Msg_IP_NM_EnableFlag = @sysvar::MESSAGEFRAME::Msg_IP_NMMessageEnable & @sysvar::NODE::IPEnableAll_Msg;
  }
}

/**************************************************************************************************/
/*
  brief:        Check the CheckBox IP_380 MessageEnable
  
  author:       Generation tool
*/
/**************************************************************************************************/
 on sysvar MESSAGEFRAME::IP_380MessageEnable
{
  IP_380_EnableFlag = @sysvar::MESSAGEFRAME::IP_380MessageEnable & @sysvar::NODE::IPEnableAll_Msg;
}

/**************************************************************************************************/
/*
  brief:        Check the CheckBox Msg_IP_NM MessageEnable
  
  author:       Generation tool
*/
/**************************************************************************************************/
 on sysvar MESSAGEFRAME::Msg_IP_NMMessageEnable
{
  Msg_IP_NM_EnableFlag = @sysvar::MESSAGEFRAME::Msg_IP_NMMessageEnable & @sysvar::NODE::IPEnableAll_Msg;
}

