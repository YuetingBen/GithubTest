/*MMMMMMMMMMMMNNNNNMMMMMMMMMMMMMMMMMMMMMMMMMMMNNNNNMMMMMMMMMMMMMMMMMMMMMMMMMMMNNNNNNMMMMMMMMMMMMM*/
/*M+NMMMNdyso+////++oyhmNMMMMMMMMMMMMMMMNmhso++////+oshmNMMMMMMMMMMMMMMMNmhyo++////+osydNNNNMNNNM*/
/*M+NMMd///+osyyyyss+///+smNMMMMMMMMMNds+///osyyyyyso////sdNMMMMMMMMMNmy+///+osyyyyso+///ohNNNNNM*/
/*M+NNMdohmNNMNNNNNNNNdy+//odNMMMMNNh+//+ymNNNNNNNNNNNmy+//+hNNNNNNNdo//+sdNNNNNNNNNNNmho//+yNNNM*/
/*M+NNNNNNNmhysooosydNNNNh+//yNNNNms//+dNNNNdysooosydNNNNdo//omNNNNy//+hNNNNdysooooyhmNNNms//+dNM*/
/*M+NNNNNdo//////////+ymNNmo//smmdo//sNNNms///////////sdmmdo//+dmms//omNNNy+//////////odmmms//+dM*/
/*M+mNNNy//////////////+mNNm+///////oNNNd+//////////////////////////+mNNm+/////////////////////oM*/
/*M+mNNd////////////////sNNNmdddhhhhmNNm+////////////////hhhhhhhhhhhdNNNmhhhhhhhhhhhhhhhhhhhh///M*/
/*M+mNNd////////////////oNNNNNNNNNNNNNNm+////////////////dNNNNNNNNNNNNNNNNNNNNNNNNNNNNNNNNNNm+//M*/
/*M/hNNmo///////////////hNNNs///////yNNNy///////////////////////////////////////////////omNNh//+M*/
/*M/+dNNms////////////+hNNNy//+sss///hNNmy/////////////ssss+///sss+///ssss+////////////smNNd+//yM*/
/*M//+hmNNmyo+/////+shmNNms//+dNNNh+//ymNNmho+/////+ohmNNmy///hNNNd+//odNNmhs+//////oymNNmh+//ymM*/
/*Mh+//+ymNNNmmmdmmNNNmds///smNNNNNdo//+ydmNNNmmdmmmNNmdy+//odNNNNNms///sdmNNNmmdmmmNNNmy+//+hmNM*/
/*Mmmho///+syhdddddhyo+///sdmNNNNNNNmho///+syhdddddhys+///ohmNNNNNNNNds+//+oyhdddddhys+///ohmNNNM*/
/*Mmmmmdyo+///////////oshmmmNmmmmmmNNmmmhs+///////////+shmmNNNNNNNNNNNNmhso///////////+oydmNNmmmM*/
/*MmmmmmmmmmdhyyyyhddmmmmmmmmmmmmmmmmmmmmmmmddhyyyhddmmmmmmmmmmmmmmmmmmmmmmmddhyyyyhdmmmmmmmmmmmM*/
/*MMMMMMMMMMMMNNNNNMMMMMMMMMMMMMMMMMMMMMMMMMMMNNNNNMMMMMMMMMMMMMMMMMMMMMMMMMMMNNNNNNMMMMMMMMMMMMM*

  filename:     GW.can
  
  description:  Brief: GW
                Generation date: 14/08/2020 17:38:42
                DBC File: CAN_Matrix_ESCL_20200814.dbc
                User Name: BenY
                
  ATTENTIONS:   This file code generated by Tool automatically, don't modify this 
                file manually.  
 ----------------------------------------------------------------------------- */
/* -----------------------------------------------------------------------------
  C O P Y R I G H T
 -------------------------------------------------------------------------------
  Copyright (c) 2019 by Yueting Ben. All rights reserved.
 -------------------------------------------------------------------------------
/**************************************************************************************************/
 variables
{
  message GW_501 GW_501_Frame;
  message Msg_GW_NM Msg_GW_NM_Frame;
  message GW_320 GW_320_Frame;
  msTimer GW_501_Timer;
  msTimer Msg_GW_NM_Timer;
  msTimer GW_320_Timer;
  byte GW_501_EnableFlag;
  byte Msg_GW_NM_EnableFlag;
  byte GW_320_EnableFlag;
}
on start
{
  setTimer(GW_501_Timer, 0);
  setTimer(Msg_GW_NM_Timer, 0);
  setTimer(GW_320_Timer, 0);
  GW_501_EnableFlag = @sysvar::MESSAGEFRAME::GW_501MessageEnable & @sysvar::NODE::GWEnableAll_Msg;
  Msg_GW_NM_EnableFlag = @sysvar::MESSAGEFRAME::Msg_GW_NMMessageEnable & @sysvar::NODE::GWEnableAll_Msg;
  GW_320_EnableFlag = @sysvar::MESSAGEFRAME::GW_320MessageEnable & @sysvar::NODE::GWEnableAll_Msg;
}

/**************************************************************************************************/
/*
  brief:        Send GW_501 in cycle
  
  author:       Generation tool
*/
/**************************************************************************************************/
 on Timer GW_501_Timer
{
  if(1 == GW_501_EnableFlag)
  {
    output(GW_501_Frame);
  }
  GW_501_Frame.HU_LocalTimeYear = @sysvar::SIGNALINFO::HU_LocalTimeYearValue;
  GW_501_Frame.HU_LocalTimeValid = @sysvar::SIGNALINFO::HU_LocalTimeValidValue;
  GW_501_Frame.HU_LocalTimeSecond = @sysvar::SIGNALINFO::HU_LocalTimeSecondValue;
  GW_501_Frame.HU_LocalTimeMinute = @sysvar::SIGNALINFO::HU_LocalTimeMinuteValue;
  GW_501_Frame.HU_LocalTimeHour = @sysvar::SIGNALINFO::HU_LocalTimeHourValue;
  GW_501_Frame.HU_LocalTimeDate = @sysvar::SIGNALINFO::HU_LocalTimeDateValue;
  GW_501_Frame.HU_LocalTimeMonth = @sysvar::SIGNALINFO::HU_LocalTimeMonthValue;
  setTimer(GW_501_Timer, 1000);
}

/**************************************************************************************************/
/*
  brief:        Send Msg_GW_NM in cycle
  
  author:       Generation tool
*/
/**************************************************************************************************/
 on Timer Msg_GW_NM_Timer
{
  if(1 == Msg_GW_NM_EnableFlag)
  {
    output(Msg_GW_NM_Frame);
  }
  setTimer(Msg_GW_NM_Timer, 500);
}

/**************************************************************************************************/
/*
  brief:        Send GW_320 in cycle
  
  author:       Generation tool
*/
/**************************************************************************************************/
 on Timer GW_320_Timer
{
  if(1 == GW_320_EnableFlag)
  {
    output(GW_320_Frame);
  }
  GW_320_Frame.ESP_VehicleSpeedValid = @sysvar::SIGNALINFO::ESP_VehicleSpeedValidValue;
  GW_320_Frame.ESP_VehicleSpeed = @sysvar::SIGNALINFO::ESP_VehicleSpeedValue;
  setTimer(GW_320_Timer, 100);
}

/**************************************************************************************************/
/*
  brief:        Check the CheckBox GW_EnableAll_Msg
  
  author:       Generation tool
*/
/**************************************************************************************************/
 on sysvar NODE::GWEnableAll_Msg
{
  if(1 == @sysvar::NODE::GWEnableAll_Msg)
  {
    @sysvar::NODE::GWEnableAll_Msg = 1;
    @sysvar::NODE::GWDisableAll_Msg = 0;
    @sysvar::MESSAGEFRAME::GW_501MessageEnable = 1;
    GW_501_EnableFlag = @sysvar::MESSAGEFRAME::GW_501MessageEnable & @sysvar::NODE::GWEnableAll_Msg;
    @sysvar::MESSAGEFRAME::Msg_GW_NMMessageEnable = 1;
    Msg_GW_NM_EnableFlag = @sysvar::MESSAGEFRAME::Msg_GW_NMMessageEnable & @sysvar::NODE::GWEnableAll_Msg;
    @sysvar::MESSAGEFRAME::GW_320MessageEnable = 1;
    GW_320_EnableFlag = @sysvar::MESSAGEFRAME::GW_320MessageEnable & @sysvar::NODE::GWEnableAll_Msg;
  }
  else
  {
    @sysvar::NODE::GWEnableAll_Msg = 0;
    @sysvar::NODE::GWDisableAll_Msg = 1;
    @sysvar::MESSAGEFRAME::GW_501MessageEnable = 0;
    GW_501_EnableFlag = @sysvar::MESSAGEFRAME::GW_501MessageEnable & @sysvar::NODE::GWEnableAll_Msg;
    @sysvar::MESSAGEFRAME::Msg_GW_NMMessageEnable = 0;
    Msg_GW_NM_EnableFlag = @sysvar::MESSAGEFRAME::Msg_GW_NMMessageEnable & @sysvar::NODE::GWEnableAll_Msg;
    @sysvar::MESSAGEFRAME::GW_320MessageEnable = 0;
    GW_320_EnableFlag = @sysvar::MESSAGEFRAME::GW_320MessageEnable & @sysvar::NODE::GWEnableAll_Msg;
  }
}

/**************************************************************************************************/
/*
  brief:        Check the CheckBox GW_DisableAll_Msg
  
  author:       Generation tool
*/
/**************************************************************************************************/
 on sysvar NODE::GWDisableAll_Msg
{
  if(1 == @sysvar::NODE::GWDisableAll_Msg)
  {
    @sysvar::NODE::GWEnableAll_Msg = 0;
    @sysvar::NODE::GWDisableAll_Msg = 1;
    @sysvar::MESSAGEFRAME::GW_501MessageEnable = 0;
    GW_501_EnableFlag = @sysvar::MESSAGEFRAME::GW_501MessageEnable & @sysvar::NODE::GWEnableAll_Msg;
    @sysvar::MESSAGEFRAME::Msg_GW_NMMessageEnable = 0;
    Msg_GW_NM_EnableFlag = @sysvar::MESSAGEFRAME::Msg_GW_NMMessageEnable & @sysvar::NODE::GWEnableAll_Msg;
    @sysvar::MESSAGEFRAME::GW_320MessageEnable = 0;
    GW_320_EnableFlag = @sysvar::MESSAGEFRAME::GW_320MessageEnable & @sysvar::NODE::GWEnableAll_Msg;
  }
  else
  {
    @sysvar::NODE::GWEnableAll_Msg = 1;
    @sysvar::NODE::GWDisableAll_Msg = 0;
    @sysvar::MESSAGEFRAME::GW_501MessageEnable = 1;
    GW_501_EnableFlag = @sysvar::MESSAGEFRAME::GW_501MessageEnable & @sysvar::NODE::GWEnableAll_Msg;
    @sysvar::MESSAGEFRAME::Msg_GW_NMMessageEnable = 1;
    Msg_GW_NM_EnableFlag = @sysvar::MESSAGEFRAME::Msg_GW_NMMessageEnable & @sysvar::NODE::GWEnableAll_Msg;
    @sysvar::MESSAGEFRAME::GW_320MessageEnable = 1;
    GW_320_EnableFlag = @sysvar::MESSAGEFRAME::GW_320MessageEnable & @sysvar::NODE::GWEnableAll_Msg;
  }
}

/**************************************************************************************************/
/*
  brief:        Check the CheckBox GW_501 MessageEnable
  
  author:       Generation tool
*/
/**************************************************************************************************/
 on sysvar MESSAGEFRAME::GW_501MessageEnable
{
  GW_501_EnableFlag = @sysvar::MESSAGEFRAME::GW_501MessageEnable & @sysvar::NODE::GWEnableAll_Msg;
}

/**************************************************************************************************/
/*
  brief:        Check the CheckBox Msg_GW_NM MessageEnable
  
  author:       Generation tool
*/
/**************************************************************************************************/
 on sysvar MESSAGEFRAME::Msg_GW_NMMessageEnable
{
  Msg_GW_NM_EnableFlag = @sysvar::MESSAGEFRAME::Msg_GW_NMMessageEnable & @sysvar::NODE::GWEnableAll_Msg;
}

/**************************************************************************************************/
/*
  brief:        Check the CheckBox GW_320 MessageEnable
  
  author:       Generation tool
*/
/**************************************************************************************************/
 on sysvar MESSAGEFRAME::GW_320MessageEnable
{
  GW_320_EnableFlag = @sysvar::MESSAGEFRAME::GW_320MessageEnable & @sysvar::NODE::GWEnableAll_Msg;
}

