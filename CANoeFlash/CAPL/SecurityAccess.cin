/*@!Encoding:936*/
/*M+NMMMNdyso+////++oyhmNMMMMMMMMMMMMMMMNmhso++////+oshmNMMMMMMMMMMMMMMMNmhyo++////+osydNNNNMNNNM*/
/*M+NMMd///+osyyyyss+///+smNMMMMMMMMMNds+///osyyyyyso////sdNMMMMMMMMMNmy+///+osyyyyso+///ohNNNNNM*/
/*M+NNMdohmNNMNNNNNNNNdy+//odNMMMMNNh+//+ymNNNNNNNNNNNmy+//+hNNNNNNNdo//+sdNNNNNNNNNNNmho//+yNNNM*/
/*M+NNNNNNNmhysooosydNNNNh+//yNNNNms//+dNNNNdysooosydNNNNdo//omNNNNy//+hNNNNdysooooyhmNNNms//+dNM*/
/*M+NNNNNdo//////////+ymNNmo//smmdo//sNNNms///////////sdmmdo//+dmms//omNNNy+//////////odmmms//+dM*/
/*M+mNNNy//////////////+mNNm+///////oNNNd+//////////////////////////+mNNm+/////////////////////oM*/
/*M+mNNd////////////////sNNNmdddhhhhmNNm+////////////////hhhhhhhhhhhdNNNmhhhhhhhhhhhhhhhhhhhh///M*/
/*M+mNNd////////////////oNNNNNNNNNNNNNNm+////////////////dNNNNNNNNNNNNNNNNNNNNNNNNNNNNNNNNNNm+//M*/
/*M/hNNmo///////////////hNNNs///////yNNNy///////////////////////////////////////////////omNNh//+M*/
/*M/+dNNms////////////+hNNNy//+sss///hNNmy/////////////ssss+///sss+///ssss+////////////smNNd+//yM*/
/*M//+hmNNmyo+/////+shmNNms//+dNNNh+//ymNNmho+/////+ohmNNmy///hNNNd+//odNNmhs+//////oymNNmh+//ymM*/
/*Mh+//+ymNNNmmmdmmNNNmds///smNNNNNdo//+ydmNNNmmdmmmNNmdy+//odNNNNNms///sdmNNNmmdmmmNNNmy+//+hmNM*/
/*Mmmho///+syhdddddhyo+///sdmNNNNNNNmho///+syhdddddhys+///ohmNNNNNNNNds+//+oyhdddddhys+///ohmNNNM*/
/*Mmmmmdyo+///////////oshmmmNmmmmmmNNmmmhs+///////////+shmmNNNNNNNNNNNNmhso///////////+oydmNNmmmM*/
/*MmmmmmmmmmdhyyyyhddmmmmmmmmmmmmmmmmmmmmmmmddhyyyhddmmmmmmmmmmmmmmmmmmmmmmmddhyyyyhdmmmmmmmmmmmM*/
/*MMMMMMMMMMMMNNNNNMMMMMMMMMMMMMMMMMMMMMMMMMMMNNNNNMMMMMMMMMMMMMMMMMMMMMMMMMMMNNNNNNMMMMMMMMMMMMM
*            $Workfile::   SecurityAccess.cin                              $                                    *
*            $Revision: 1.4 $                                    *
*         from $Author: Yueting Ben (BenY) $                                    *
*  Last check in $Date: 2019/03/12 13:12:02CST $                                    *
*        Last $Modtime::   Jul 22 2015 10:34:50               $                                    *
****************************************************************************************************
*  Responsible for this file:    Yueting.Ben                                                           *
*  Backup for this file:         Yueting.Ben                                                            *
***************************************************************************************************/
/** \file
    \ingroup SecurityAccess                                                                                  */
/**************************************************************************************************/
/** \defgroup  SecurityAccess SecurityAccess
    \ingroup   Application
    \brief   The SecurityAccess functional module. <br>
    
             Note: 
             Should add SecurityAccess functions in this file for different project.
             Should put right relationship in security_access_calc(enum SECURITYTYPE securityType)
             
*/

/**************************************************************************************************/
includes
{
}

variables
{
  enum SECURITY_CAL_STATUS
  {
    SECURITY_INITIAL_STEP = 0,
    SECURITY_SEED_STEP,
    SECURITY_KEY_STEP,
    SECURITY_FINISHED_STEP
  };
  enum SECURITY_CAL_STATUS SecurityCalStatus = SECURITY_INITIAL_STEP; 
  
  byte Var[16] = {0xB6,0x52,0xA9,0xA4,0x2B,0x8A,0x87,0x8B,0xDD,0x28,0xE6,0xF7,0x61,0x2D,0xD9,0x58};  
  
  byte Sbox[256] =
  { /*  0    1    2    3    4    5    6    7    8    9    a    b    c    d    e    f */
    0x63, 0x7c, 0x77, 0x7b, 0xf2, 0x6b, 0x6f, 0xc5, 0x30, 0x01, 0x67, 0x2b, 0xfe, 0xd7, 0xab, 0x76, /*0*/
    0xca, 0x82, 0xc9, 0x7d, 0xfa, 0x59, 0x47, 0xf0, 0xad, 0xd4, 0xa2, 0xaf, 0x9c, 0xa4, 0x72, 0xc0, /*1*/
    0xb7, 0xfd, 0x93, 0x26, 0x36, 0x3f, 0xf7, 0xcc, 0x34, 0xa5, 0xe5, 0xf1, 0x71, 0xd8, 0x31, 0x15, /*2*/
    0x04, 0xc7, 0x23, 0xc3, 0x18, 0x96, 0x05, 0x9a, 0x07, 0x12, 0x80, 0xe2, 0xeb, 0x27, 0xb2, 0x75, /*3*/
    0x09, 0x83, 0x2c, 0x1a, 0x1b, 0x6e, 0x5a, 0xa0, 0x52, 0x3b, 0xd6, 0xb3, 0x29, 0xe3, 0x2f, 0x84, /*4*/
    0x53, 0xd1, 0x00, 0xed, 0x20, 0xfc, 0xb1, 0x5b, 0x6a, 0xcb, 0xbe, 0x39, 0x4a, 0x4c, 0x58, 0xcf, /*5*/
    0xd0, 0xef, 0xaa, 0xfb, 0x43, 0x4d, 0x33, 0x85, 0x45, 0xf9, 0x02, 0x7f, 0x50, 0x3c, 0x9f, 0xa8, /*6*/
    0x51, 0xa3, 0x40, 0x8f, 0x92, 0x9d, 0x38, 0xf5, 0xbc, 0xb6, 0xda, 0x21, 0x10, 0xff, 0xf3, 0xd2, /*7*/
    0xcd, 0x0c, 0x13, 0xec, 0x5f, 0x97, 0x44, 0x17, 0xc4, 0xa7, 0x7e, 0x3d, 0x64, 0x5d, 0x19, 0x73, /*8*/
    0x60, 0x81, 0x4f, 0xdc, 0x22, 0x2a, 0x90, 0x88, 0x46, 0xee, 0xb8, 0x14, 0xde, 0x5e, 0x0b, 0xdb, /*9*/
    0xe0, 0x32, 0x3a, 0x0a, 0x49, 0x06, 0x24, 0x5c, 0xc2, 0xd3, 0xac, 0x62, 0x91, 0x95, 0xe4, 0x79, /*a*/
    0xe7, 0xc8, 0x37, 0x6d, 0x8d, 0xd5, 0x4e, 0xa9, 0x6c, 0x56, 0xf4, 0xea, 0x65, 0x7a, 0xae, 0x08, /*b*/
    0xba, 0x78, 0x25, 0x2e, 0x1c, 0xa6, 0xb4, 0xc6, 0xe8, 0xdd, 0x74, 0x1f, 0x4b, 0xbd, 0x8b, 0x8a, /*c*/
    0x70, 0x3e, 0xb5, 0x66, 0x48, 0x03, 0xf6, 0x0e, 0x61, 0x35, 0x57, 0xb9, 0x86, 0xc1, 0x1d, 0x9e, /*d*/
    0xe1, 0xf8, 0x98, 0x11, 0x69, 0xd9, 0x8e, 0x94, 0x9b, 0x1e, 0x87, 0xe9, 0xce, 0x55, 0x28, 0xdf, /*e*/
    0x8c, 0xa1, 0x89, 0x0d, 0xbf, 0xe6, 0x42, 0x68, 0x41, 0x99, 0x2d, 0x0f, 0xb0, 0x54, 0xbb, 0x16  /*f*/
  };
  byte InvSbox[256] =
  { /*  0    1    2    3    4    5    6    7    8    9    a    b    c    d    e    f  */
    0x52, 0x09, 0x6a, 0xd5, 0x30, 0x36, 0xa5, 0x38, 0xbf, 0x40, 0xa3, 0x9e, 0x81, 0xf3, 0xd7, 0xfb, /*0*/
    0x7c, 0xe3, 0x39, 0x82, 0x9b, 0x2f, 0xff, 0x87, 0x34, 0x8e, 0x43, 0x44, 0xc4, 0xde, 0xe9, 0xcb, /*1*/
    0x54, 0x7b, 0x94, 0x32, 0xa6, 0xc2, 0x23, 0x3d, 0xee, 0x4c, 0x95, 0x0b, 0x42, 0xfa, 0xc3, 0x4e, /*2*/
    0x08, 0x2e, 0xa1, 0x66, 0x28, 0xd9, 0x24, 0xb2, 0x76, 0x5b, 0xa2, 0x49, 0x6d, 0x8b, 0xd1, 0x25, /*3*/
    0x72, 0xf8, 0xf6, 0x64, 0x86, 0x68, 0x98, 0x16, 0xd4, 0xa4, 0x5c, 0xcc, 0x5d, 0x65, 0xb6, 0x92, /*4*/
    0x6c, 0x70, 0x48, 0x50, 0xfd, 0xed, 0xb9, 0xda, 0x5e, 0x15, 0x46, 0x57, 0xa7, 0x8d, 0x9d, 0x84, /*5*/
    0x90, 0xd8, 0xab, 0x00, 0x8c, 0xbc, 0xd3, 0x0a, 0xf7, 0xe4, 0x58, 0x05, 0xb8, 0xb3, 0x45, 0x06, /*6*/
    0xd0, 0x2c, 0x1e, 0x8f, 0xca, 0x3f, 0x0f, 0x02, 0xc1, 0xaf, 0xbd, 0x03, 0x01, 0x13, 0x8a, 0x6b, /*7*/
    0x3a, 0x91, 0x11, 0x41, 0x4f, 0x67, 0xdc, 0xea, 0x97, 0xf2, 0xcf, 0xce, 0xf0, 0xb4, 0xe6, 0x73, /*8*/
    0x96, 0xac, 0x74, 0x22, 0xe7, 0xad, 0x35, 0x85, 0xe2, 0xf9, 0x37, 0xe8, 0x1c, 0x75, 0xdf, 0x6e, /*9*/
    0x47, 0xf1, 0x1a, 0x71, 0x1d, 0x29, 0xc5, 0x89, 0x6f, 0xb7, 0x62, 0x0e, 0xaa, 0x18, 0xbe, 0x1b, /*a*/
    0xfc, 0x56, 0x3e, 0x4b, 0xc6, 0xd2, 0x79, 0x20, 0x9a, 0xdb, 0xc0, 0xfe, 0x78, 0xcd, 0x5a, 0xf4, /*b*/
    0x1f, 0xdd, 0xa8, 0x33, 0x88, 0x07, 0xc7, 0x31, 0xb1, 0x12, 0x10, 0x59, 0x27, 0x80, 0xec, 0x5f, /*c*/
    0x60, 0x51, 0x7f, 0xa9, 0x19, 0xb5, 0x4a, 0x0d, 0x2d, 0xe5, 0x7a, 0x9f, 0x93, 0xc9, 0x9c, 0xef, /*d*/
    0xa0, 0xe0, 0x3b, 0x4d, 0xae, 0x2a, 0xf5, 0xb0, 0xc8, 0xeb, 0xbb, 0x3c, 0x83, 0x53, 0x99, 0x61, /*e*/
    0x17, 0x2b, 0x04, 0x7e, 0xba, 0x77, 0xd6, 0x26, 0xe1, 0x69, 0x14, 0x63, 0x55, 0x21, 0x0c, 0x7d  /*f*/
  }; 
  
  byte w[11][4][4];
  byte state[4][4];
  byte input[16];
  /* GEELY FE-6 */
  const SECURITY_ACCESS_DATA_LENGTH = 4;
  byte xorArray_lv01_lv03_lv11[SECURITY_ACCESS_DATA_LENGTH] = {0xE9, 0x4A, 0x22, 0x91};
  byte xorArray_lv61[SECURITY_ACCESS_DATA_LENGTH] = {0x49, 0x22, 0xA5, 0x0F};
  byte seedArray[SECURITY_ACCESS_DATA_LENGTH];
  byte returnKey[SECURITY_ACCESS_DATA_LENGTH];
}


/**************************************************************************************************/
/**
    \brief   Call the corresponding key calculation function based on the parameter <br>
             Call by function SecurityAccess_27_Seed()
             
    \param   securityType -> OEM_SECURITY
             securityType -> FLASH_SECURITY
             securityType -> SUPPLIER_SECURITY
    
    \author  Yueting.Ben
*/
/**************************************************************************************************/
void security_access_calc(enum SECURITYTYPE securityType)
{
  if('A' == projectCfg)
  {
    /* A: GEELY_FE_6 */
    if(OEM_SECURITY == securityType)
    {
      security_accessLv01_calc();
    }
    else if(FLASH_SECURITY == securityType)
    {
      security_accessLv11_calc();
    }
    else if(SUPPLIER_SECURITY == securityType)
    {
      security_accessLv61_calc();
    }
  }
  else if('B' == projectCfg)
  {
    /* B: GAC A26 */
    if(OEM_SECURITY == securityType)
    {
      A5H_ESCL_L1_SeedToKey();
    }
    else if(FLASH_SECURITY == securityType)
    {
      A5H_ESCL_Flash_SeedToKey();
    }
  }
  else if('C' == projectCfg)
  {
    /* C: GAC A12 */
    if(OEM_SECURITY == securityType)
    {
      Seed2Key(0x02);
    }
    else if(FLASH_SECURITY == securityType)
    {
      Seed2Key(0x11);
    }
  }
  else if('D' == projectCfg)
  {
    /* D: SAIC SK83 */
    if(OEM_SECURITY == securityType)
    {
      SaicSk83_Seed2Key(0x01);
    }
    else if(SAIC_FLASH_SECURITY == securityType)
    {
      SaicSk83_Seed2Key(0x11);
    }
  }
}


/**************************************************************************************************/
/**
    \brief   GEELY FE-6 security_accessLv01 <br>
             
    \author  Yueting.Ben
*/
/**************************************************************************************************/
void security_accessLv01_calc()
{
  int i = 0;
  byte calData[SECURITY_ACCESS_DATA_LENGTH];
  
  for (i = 0; i < SECURITY_ACCESS_DATA_LENGTH; i++)
  {
    calData[i] = seedArray[i]^xorArray_lv01_lv03_lv11[i];
  }
  
  returnKey[0] = ((calData[3]&0x0F)<<4) | ((calData[3]&0xF0)>>0);
  returnKey[1] = ((calData[1]&0x0F)<<4) | ((calData[0]&0xF0)>>4);
  returnKey[2] = ((calData[1]&0xF0)<<0) | ((calData[2]&0xF0)>>4);
  returnKey[3] = ((calData[0]&0x0F)<<4) | ((calData[2]&0x0F)>>0);
}


/**************************************************************************************************/
/**
    \brief   GEELY FE-6 security_accessLv03 <br>
             
    \author  Yueting.Ben
*/
/**************************************************************************************************/
void security_accessLv03_calc()
{
  byte i = 0;
  byte calData[SECURITY_ACCESS_DATA_LENGTH];
  
  for (i = 0; i < SECURITY_ACCESS_DATA_LENGTH; i++)
  {
    calData[i] = ((seedArray[i]&0xF8)>>3)^xorArray_lv01_lv03_lv11[i];
  }
  
  returnKey[0] = ((calData[3]&0x07)<<5) | ((calData[0]&0xF8)>>3);
  returnKey[1] = ((calData[0]&0x07)<<5) | ((calData[2]&0x1F)>>0);
  returnKey[2] = ((calData[1]&0xF8)<<0) | ((calData[3]&0xE0)>>5);
  returnKey[3] = ((calData[2]&0xF8)<<0) | ((calData[1]&0x07)>>0);
}


/**************************************************************************************************/
/**
    \brief   GEELY FE-6 security_accessLv11 <br>
             
    \author  Yueting.Ben
*/
/**************************************************************************************************/
void security_accessLv11_calc()
{
   byte i = 0;
   byte calData[SECURITY_ACCESS_DATA_LENGTH];

  for (i = 0; i < SECURITY_ACCESS_DATA_LENGTH; i++)
  {
    calData[i] = seedArray[i]^xorArray_lv01_lv03_lv11[i];
  }
  
  returnKey[0] = ((calData[2]&0x03)<<6) | ((calData[3]&0xFC)>>2);
  returnKey[1] = ((calData[3]&0x03)<<6) | ((calData[0]&0x3F)>>0);
  returnKey[2] = ((calData[0]&0xFC)<<0) | ((calData[1]&0xC0)>>6);
  returnKey[3] = ((calData[1]&0xFC)<<0) | ((calData[2]&0x03)>>0);
}



/**************************************************************************************************/
/**
    \brief   GEELY FE-6 security_accessLv61 <br>
             
    \author  Yueting.Ben
*/
/**************************************************************************************************/
void security_accessLv61_calc()
{
  byte i = 0;
  byte calData[SECURITY_ACCESS_DATA_LENGTH];
  
  for (i = 0; i < SECURITY_ACCESS_DATA_LENGTH; i++)
  {
    calData[i] = seedArray[i]^xorArray_lv61[i];
  }
  
  returnKey[0] = ((calData[2]&0x03)<<6) | ((calData[3]&0xFC)>>2);
  returnKey[1] = ((calData[3]&0x03)<<6) | ((calData[0]&0x3F)>>0);
  returnKey[2] = ((calData[0]&0xFC)<<0) | ((calData[1]&0xC0)>>6);
  returnKey[3] = ((calData[1]&0xFC)<<0) | ((calData[2]&0x03)>>0);
}


/**************************************************************************************************/
/**
    \brief   GAC A26 Level 1 <br>

    \author  Yueting.Ben
*/
/**************************************************************************************************/
void A5H_ESCL_L1_SeedToKey()
{  
  byte i = 0;
  dword pin;

  pin = 0x19715131;

  for( i = 0; i < 4; i++)
  {
    pin ^= ((pin << 5) + seedArray[i] + (pin >> 4));
  }

  for(i = 0; i < 4; i++)
  {
    returnKey[i] = ( pin >> (i * 8)) & 0xFF;
  }
}

/**************************************************************************************************/
/**
    \brief   GAC A26 Level Flash <br>

    \author  Yueting.Ben
*/
/**************************************************************************************************/
void A5H_ESCL_Flash_SeedToKey()
{  
  byte i = 0;
  dword pin;

  pin = 0x51375028;

  for( i = 0; i < 4; i++)
  {
    pin ^= ((pin << 5) + seedArray[i] + (pin >> 4));
  }

  for(i = 0; i < 4; i++)
  {
    returnKey[i] = ( pin >> (i * 8)) & 0xFF;
  }
}


/**************************************************************************************************/
/**
    \brief   Security_Cal_Task <br>
             
    \author  Yueting.Ben
*/
/**************************************************************************************************/
void Security_Cal_Task()
{
  enum TRUE_FALSE temp = FALSE;
  dword glb_ReflashFile_Handle = 0;
  dword i;
  
  switch (SecurityCalStatus)
  {
    case SECURITY_INITIAL_STEP:
    {      
      if(TRUE == SecurityCalTaskEnable)
      {
        write("INITIAL_STEP");        
        SecurityCalStatus = SECURITY_SEED_STEP;
        SendNextStepEnable = TRUE;
      }
      break;
    }
    case SECURITY_SEED_STEP: 
    {
      
      if((TRUE == SendNextStepEnable))
      {
        write("REFLASH_SECURITY_SEED_STEP");
        SendNextStepEnable = FALSE;
        
        SecurityAccess_27_Seed_Triger = TRUE;        
        
        SecurityCalStatus = SECURITY_KEY_STEP;
      }
      break;
    }

    case SECURITY_KEY_STEP: 
    {
      if((TRUE == SendNextStepEnable) && (FALSE == SecurityAccess_27_Seed_Triger))
      {
        write("REFLASH_SECURITY_KEY_STEP");
        SendNextStepEnable = FALSE;
        
        SecurityAccess_27_Key_Triger = TRUE;        
        
        SecurityCalStatus = SECURITY_FINISHED_STEP;
      }
      break;
    }
    
    case SECURITY_FINISHED_STEP: 
    {
      SecurityCalStatus = SECURITY_FINISHED_STEP;
      SecurityCalTaskEnable = FALSE;
      break;
    }
    default: 
    {
      break;
    }
  }
}

/**************************************************************************************************/
/**
    \brief   AES_Init <br>
             
    \author  Yueting.Ben
*/
/**************************************************************************************************/
void AES_Init(byte keys[])
{
  KeyExpansion(keys);
}

/**************************************************************************************************/
/**
    \brief   AES_Cipher <br>
             
    \author  Yueting.Ben
*/
/**************************************************************************************************/
void AES_Cipher()
{
  int i, r, c;
  for (r = 0; r<4; r++)
  {
    for (c = 0; c<4; c++)
    {
      state[r][c] = input[c * 4 + r];
    }
  }
  AddRoundKey(0);
  for (i = 1; i <= 10; i++)
  {
    SubBytes();
    ShiftRows();
    if (i != 10)MixColumns();
    AddRoundKey(i);
  }
  
  for (r = 0; r<4; r++)
  {
    for (c = 0; c<4; c++)
    {
      input[c * 4 + r] = state[r][c];
    }
  }
}

/**************************************************************************************************/
/**
    \brief   KeyExpansion <br>
             
    \author  Yueting.Ben
*/
/**************************************************************************************************/
void KeyExpansion(byte keys[])
{
  byte i, j, r, c;
  byte rc[10] = {0x01, 0x02, 0x04, 0x08, 0x10, 0x20, 0x40, 0x80, 0x1b, 0x36};
  byte t[4] = {0x00, 0x00, 0x00, 0x00};
  byte temp;
  
  for (r = 0; r<4; r++)
  {
    for (c = 0; c<4; c++)
    {
      w[0][r][c] = keys[r + c * 4];
    }
  }
  for (i = 1; i <= 10; i++)
  {
    for (j = 0; j<4; j++)
    {
      
      for (r = 0; r<4; r++)
      {
        t[r] = j ? w[i][r][j - 1] : w[i - 1][r][3];
      }
      if(j == 0)
      {
        temp = t[0];
        for (r = 0; r<3; r++)
        {
          t[r] = Sbox[t[(r + 1) % 4]];
        }
        t[3] = Sbox[temp];
        t[0] ^= rc[i - 1];
      }
      for (r = 0; r<4; r++)
      {
        w[i][r][j] = w[i - 1][r][j] ^ t[r];
      }
    }
  }
}

/**************************************************************************************************/
/**
    \brief   FFmul <br>
             
    \author  Yueting.Ben
*/
/**************************************************************************************************/
byte FFmul(byte a, byte b)
{
  byte bw[4];
  byte res;
  byte i;

  bw[0] = b;
  res = 0;
  
  for (i = 1; i<4; i++)
  {
    bw[i] = bw[i - 1] << 1;
    if (bw[i - 1] & 0x80)
    {
      bw[i] ^= 0x1b;
    }
  }
  for (i = 0; i<4; i++)
  {
    if ((a >> i) & 0x01)
    {
      res ^= bw[i];
    }
  }
  return res;
}

/**************************************************************************************************/
/**
    \brief   SubBytes <br>
             
    \author  Yueting.Ben
*/
/**************************************************************************************************/
void SubBytes()
{
  int r, c;
  for (r = 0; r<4; r++)
  {
    for (c = 0; c<4; c++)
    {
      state[r][c] = Sbox[state[r][c]];
    }
  }
}

/**************************************************************************************************/
/**
    \brief   ShiftRows <br>
             
    \author  Yueting.Ben
*/
/**************************************************************************************************/
void ShiftRows()
{
  byte t[4];
  int r, c;
  for (r = 1; r<4; r++)
  {
    for (c = 0; c<4; c++)
    {
      t[c] = state[r][(c + r) % 4];
    }
    for (c = 0; c<4; c++)
    {
      state[r][c] = t[c];
    }
  }
}

/**************************************************************************************************/
/**
    \brief   MixColumns <br>
             
    \author  Yueting.Ben
*/
/**************************************************************************************************/
void MixColumns()
{
  byte t[4];
  int r, c;
  for (c = 0; c< 4; c++)
  {
    for (r = 0; r<4; r++)
    {
      t[r] = state[r][c];
    }
    for (r = 0; r<4; r++)
    {
      state[r][c] = (FFmul(0x02, t[r])) ^ (FFmul(0x03, t[(r + 1) % 4])) ^ (FFmul(0x01, t[(r + 2) % 4])) ^ (FFmul(0x01, t[(r + 3) % 4]));
    }
  }
  
}

/**************************************************************************************************/
/**
    \brief   AddRoundKey <br>
             
    \author  Yueting.Ben
*/
/**************************************************************************************************/
void AddRoundKey(byte i)
{
  int r, c;
  for (c = 0; c<4; c++)
  {
    for (r = 0; r<4; r++)
    {
      state[r][c] ^= w[i][r][c];
    }
  }
}

/**************************************************************************************************/
/**
    \brief   GAC A12 security access Seed2Key <br>
    
    \param   iSecurityLevel: 0x01 -> Level 1
             iSecurityLevel: 0x03 -> Level 2
             iSecurityLevel: 0x11 -> Level Flash
    
    \author  Yueting.Ben
*/
/**************************************************************************************************/
void Seed2Key(byte iSecurityLevel)
{
  byte temp[16] = {0};
  byte Size;
  byte dat;
  byte data[16];
  byte i;
  dat = iSecurityLevel;
  
  AES_Init(Var);
  for (i = 0; i < 16; i++)
  {
    temp[i] = dat;
  }
  for (i = 0; i < 4; i++)
  {
    temp[i] = seedArray[i];
  }
  for (i = 0; i < 16; i++)
  {
    input[i] = temp[i];
  }
  AES_Cipher();
  for (i = 0; i < 8; i++)
  {
    data[i] = input[i] ^ input[15-i];
  }
  for (i = 0; i < 4; i++)
  {
    data[i] = data[i] ^ data[3 - i];
  }
  for (i = 0; i < 4; i++)
  {
    returnKey[i] = data[i];
  }
}


/**************************************************************************************************/
/**
    \brief   SAIC SK83 security access Seed2Key <br>
    
    \param   iSecurityLevel: 0x01 -> Level 1
             iSecurityLevel: 0x03 -> Level 2
             iSecurityLevel: 0x11 -> Level Flash
    
    \author  Yueting.Ben
*/
/**************************************************************************************************/
void SaicSk83_Seed2Key (byte iSecurityLevel)
{
  Dword seed;
  Dword mask;
  Dword keyValue;
  byte i;
  
  seed = ((seedArray[0]<<24) | (seedArray[1]<<16) | (seedArray[2]<<8) | seedArray[3]);
  
  if(0x11 == iSecurityLevel)
  {
    mask = 0x6B6B8383;
  }
  else
  {
    mask = 0x836BB683;
  }
  
  if (seed !=0 )
  {
     for (i=0; i<35; i++)
     {
       if (seed & 0x80000000)
       {
          seed = seed << 1;
          seed = seed ^ mask;
       }
       else
       {
        seed = seed << 1;
       }
     }
  
   keyValue = seed;
  }

  returnKey[0] = (keyValue >> 24) & 0x000000FF;
  returnKey[1] = (keyValue >> 16) & 0x000000FF;
  returnKey[2] = (keyValue >> 8) & 0x000000FF;
  returnKey[3] = keyValue & 0x000000FF;
}


