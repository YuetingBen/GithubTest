/*@!Encoding:936*/
/*M+NMMMNdyso+////++oyhmNMMMMMMMMMMMMMMMNmhso++////+oshmNMMMMMMMMMMMMMMMNmhyo++////+osydNNNNMNNNM*/
/*M+NMMd///+osyyyyss+///+smNMMMMMMMMMNds+///osyyyyyso////sdNMMMMMMMMMNmy+///+osyyyyso+///ohNNNNNM*/
/*M+NNMdohmNNMNNNNNNNNdy+//odNMMMMNNh+//+ymNNNNNNNNNNNmy+//+hNNNNNNNdo//+sdNNNNNNNNNNNmho//+yNNNM*/
/*M+NNNNNNNmhysooosydNNNNh+//yNNNNms//+dNNNNdysooosydNNNNdo//omNNNNy//+hNNNNdysooooyhmNNNms//+dNM*/
/*M+NNNNNdo//////////+ymNNmo//smmdo//sNNNms///////////sdmmdo//+dmms//omNNNy+//////////odmmms//+dM*/
/*M+mNNNy//////////////+mNNm+///////oNNNd+//////////////////////////+mNNm+/////////////////////oM*/
/*M+mNNd////////////////sNNNmdddhhhhmNNm+////////////////hhhhhhhhhhhdNNNmhhhhhhhhhhhhhhhhhhhh///M*/
/*M+mNNd////////////////oNNNNNNNNNNNNNNm+////////////////dNNNNNNNNNNNNNNNNNNNNNNNNNNNNNNNNNNm+//M*/
/*M/hNNmo///////////////hNNNs///////yNNNy///////////////////////////////////////////////omNNh//+M*/
/*M/+dNNms////////////+hNNNy//+sss///hNNmy/////////////ssss+///sss+///ssss+////////////smNNd+//yM*/
/*M//+hmNNmyo+/////+shmNNms//+dNNNh+//ymNNmho+/////+ohmNNmy///hNNNd+//odNNmhs+//////oymNNmh+//ymM*/
/*Mh+//+ymNNNmmmdmmNNNmds///smNNNNNdo//+ydmNNNmmdmmmNNmdy+//odNNNNNms///sdmNNNmmdmmmNNNmy+//+hmNM*/
/*Mmmho///+syhdddddhyo+///sdmNNNNNNNmho///+syhdddddhys+///ohmNNNNNNNNds+//+oyhdddddhys+///ohmNNNM*/
/*Mmmmmdyo+///////////oshmmmNmmmmmmNNmmmhs+///////////+shmmNNNNNNNNNNNNmhso///////////+oydmNNmmmM*/
/*MmmmmmmmmmdhyyyyhddmmmmmmmmmmmmmmmmmmmmmmmddhyyyhddmmmmmmmmmmmmmmmmmmmmmmmddhyyyyhdmmmmmmmmmmmM*/
/*MMMMMMMMMMMMNNNNNMMMMMMMMMMMMMMMMMMMMMMMMMMMNNNNNMMMMMMMMMMMMMMMMMMMMMMMMMMMNNNNNNMMMMMMMMMMMMM
*            $Workfile::   PanelControl.cin                              $                                    *
*            $Revision: 1.3 $                                    *
*         from $Author: Yueting Ben (BenY) $                                    *
*  Last check in $Date: 2019/02/12 11:37:44CST $                                    *
*        Last $Modtime::   Jul 22 2015 10:34:50               $                                    *
****************************************************************************************************
*  Responsible for this file:    Yueting.Ben                                                           *
*  Backup for this file:         Yueting.Ben                                                            *
***************************************************************************************************/
/** \file
    \ingroup PanelControl                                                                                  */
/**************************************************************************************************/
/** \defgroup  PanelControl PanelControl
    \ingroup   PanelControl
    \brief   The PanelControl functional module. <br>
*/

/**************************************************************************************************/


/**************************************************************************************************/
/**
    \brief   sysvar::REFLASH::ReflashTriger
    \period  Event
    \author  Yueting.Ben
*/
/**************************************************************************************************/
on sysvar_update sysvar::REFLASH::ReflashTriger
{
  if((@this == 0) && (FALSE == ReflashTaskEnable))
  {
    write("ReflashTriger");
    ReflashTaskEnable = TRUE;
    ReflashStatus = INITIAL_STEP;
  }
}


/**************************************************************************************************/
/**
    \brief   sysvar::REFLASH::TrigerTest
    \period  Event
    \author  Yueting.Ben
*/
/**************************************************************************************************/
on sysvar_update sysvar::REFLASH::TrigerTest
{
  byte i;
  
  if((@this == 0) && (FALSE == TpSendTriger))
  {
    write("SendTriger");
    TestTaskEnable = TRUE;
    TestStatus = TEST_INITIAL_STEP;
  }
}

/**************************************************************************************************/
/**
    \brief   sysvar::UDS::SessionControl
    \period  Event
    \author  Yueting.Ben
*/
/**************************************************************************************************/
on sysvar_update sysvar::UDS::SessionControl
{
  AddressedType = PHY_ADDRESSED;
  DiagnosticSessionControl_10_Triger = TRUE;
  if(FALSE == TpSendTriger)
  {
	  if(@this == 1)
	  {
	  	SessionControl_Value = DEFAULT_SESSION;
	    write("SessionControl_Default"); 
	  }
	  else if(@this == 2)
	  {
	  	SessionControl_Value = PROGRAMMING_SESSION;
	    write("SessionControl_Programming"); 
	  }
	  else if(@this == 3)
	  {
	  	SessionControl_Value = EXTENDED_SESSION;
	    write("SessionControl_Extend"); 
	  }
	 }
}


/**************************************************************************************************/
/**
    \brief   sysvar::UDS::Security
    \period  Event
    \author  Yueting.Ben
*/
/**************************************************************************************************/
on sysvar_update sysvar::UDS::Security
{
  AddressedType = PHY_ADDRESSED;
  
  SecurityCalTaskEnable = TRUE;
  SecurityCalStatus = SECURITY_INITIAL_STEP;
  
  if(FALSE == TpSendTriger)
  {
	  if(@this == 0)
	  {
	  	Security_Value = OEM_SECURITY;
	    write("OEM_SECURITY"); 
	  }
	  else if(@this == 1)
	  {
	  	Security_Value = SAIC_FLASH_SECURITY;
	    write("FLASH_SECURITY"); 
	  }
	  else if(@this == 2)
	  {
	  	Security_Value = SUPPLIER_SECURITY;
	    write("SUPPLIER_SECURITY"); 
	  }
	 }
}

/**************************************************************************************************/
/**
    \brief   sysvar::UDS::Reset
    \period  Event
    \author  Yueting.Ben
*/
/**************************************************************************************************/
on sysvar_update sysvar::UDS::Reset
{
  AddressedType = PHY_ADDRESSED;
  ECUReset_11_Triger = TRUE;
  if(FALSE == TpSendTriger)
  {
	  if(@this == 1)
	  {
	  	Reset_Value = HARDR_ESTE;
	    write("HARDR_ESTE"); 
	  }
	  else if(@this == 2)
	  {
	  	Reset_Value = KEYOFFON_RESET;
	    write("KEYOFFON_RESET"); 
	  }
	  else if(@this == 3)
	  {
	  	Reset_Value = SOFTWARE_SESSION;
	    write("SOFTWARE_SESSION"); 
	  }
	 }
}

/**************************************************************************************************/
/**
    \brief   sysvar::UDS::TesterPresent
    \period  Event
    \author  Yueting.Ben
*/
/**************************************************************************************************/
on sysvar_update sysvar::UDS::TesterPresent
{
  AddressedType = PHY_ADDRESSED;
  TesterPresent_3E_Enable = ENABLED;
  if(FALSE == TpSendTriger)
  {
  	if(@this == 0)
	  {
	  	/* Off */
			TesterPresent_3E_RespEnable = DISABLED;
	  	TesterPresent_3E_Disappear = ENABLED;
	  	
	  	TesterPresent_3E_Enable = DISABLED;
	  }
	  else if(@this == 1)
	  {
	  	/* On Disappear */
	  	TesterPresent_3E_RespEnable = DISABLED;
	  	TesterPresent_3E_Disappear = ENABLED;
	  }
	  else if(@this == 2)
	  {
	  	/* On with response */
	  	TesterPresent_3E_RespEnable = ENABLED;
	  	TesterPresent_3E_Disappear = DISABLED;
	  }
	  else if(@this == 3)
	  {
	  	/* On without response */
	  	TesterPresent_3E_RespEnable = DISABLED;
	  	TesterPresent_3E_Disappear = DISABLED;
	  }
	 }
}

/**************************************************************************************************/
/**
    \brief   sysvar::DTC::Mask_TestFailed
    \period  Event
    \author  Yueting.Ben
*/
/**************************************************************************************************/
on sysvar_update sysvar::DTC::Mask_TestFailed
{
  if(@this == 1)
  {
    DtcMask |= 0x01;
  }
  else
  {
    DtcMask &= ~(0x01);
  }
}

/**************************************************************************************************/
/**
    \brief   sysvar::DTC::Mask_TestFailedThisOperationCycle
    \period  Event
    \author  Yueting.Ben
*/
/**************************************************************************************************/
on sysvar_update sysvar::DTC::Mask_TestFailedThisOperationCycle
{
  if(@this == 1)
  {
    DtcMask |= 0x02;
  }
  else
  {
    DtcMask &= ~(0x02);
  }
}

/**************************************************************************************************/
/**
    \brief   sysvar::DTC::Mask_PendingDTC
    \period  Event
    \author  Yueting.Ben
*/
/**************************************************************************************************/
on sysvar_update sysvar::DTC::Mask_PendingDTC
{
  if(@this == 1)
  {
    DtcMask |= 0x04;
  }
  else
  {
    DtcMask &= ~(0x04);
  }
}


/**************************************************************************************************/
/**
    \brief   sysvar::DTC::Mask_ConfirmedDTC
    \period  Event
    \author  Yueting.Ben
*/
/**************************************************************************************************/
on sysvar_update sysvar::DTC::Mask_ConfirmedDTC
{
  if(@this == 1)
  {
    DtcMask |= 0x08;
  }
  else
  {
    DtcMask &= ~(0x08);
  }
}


/**************************************************************************************************/
/**
    \brief   sysvar::DTC::Mask_TestNotCompletedSinceLastClear
    \period  Event
    \author  Yueting.Ben
*/
/**************************************************************************************************/
on sysvar_update sysvar::DTC::Mask_TestNotCompletedSinceLastClear
{
  if(@this == 1)
  {
    DtcMask |= 0x10;
  }
  else
  {
    DtcMask &= ~(0x10);
  }
}


/**************************************************************************************************/
/**
    \brief   sysvar::DTC::Mask_TestFailedSinceLastClear
    \period  Event
    \author  Yueting.Ben
*/
/**************************************************************************************************/
on sysvar_update sysvar::DTC::Mask_TestFailedSinceLastClear
{
  if(@this == 1)
  {
    DtcMask |= 0x20;
  }
  else
  {
    DtcMask &= ~(0x20);
  }
}


/**************************************************************************************************/
/**
    \brief   sysvar::DTC::Mask_TestNotCompletedThisOperationCycle
    \period  Event
    \author  Yueting.Ben
*/
/**************************************************************************************************/
on sysvar_update sysvar::DTC::Mask_TestNotCompletedThisOperationCycle
{
  if(@this == 1)
  {
    DtcMask |= 0x40;
  }
  else
  {
    DtcMask &= ~(0x40);
  }
}


/**************************************************************************************************/
/**
    \brief   sysvar::DTC::Mask_WarningIndicatorRequested
    \period  Event
    \author  Yueting.Ben
*/
/**************************************************************************************************/
on sysvar_update sysvar::DTC::Mask_WarningIndicatorRequested
{
  if(@this == 1)
  {
    DtcMask |= 0x80;
  }
  else
  {
    DtcMask &= ~(0x80);
  }
}

/**************************************************************************************************/
/**
    \brief   sysvar::DTC::DTC_Instruct
    \period  Event
    \author  Yueting.Ben
*/
/**************************************************************************************************/
on sysvar_update sysvar::DTC::DTC_Instruct
{
  DTC_Display_Init_Task();
  DtcSnapshotEnable = (enum IFENABLED)(@sysvar::DTC::DTC_SnapshotTrigger);
  DtcExtendedDatatEnable = (enum IFENABLED)(@sysvar::DTC::DTC_ExtendedDataTrigger);
  /* ReportNumberOfDTCByStatusMask */
  if(@this == 1)
  {
    ReadDTCInformation_19_01_Triger = TRUE;
  }
  /* ReportDTCByStatusMask */
  else if(@this == 2)
  {
    ReadDTCInformation_19_02_Triger = TRUE;
  }
  /* ReportSupportedDTC */
  else if(@this == 5)
  {
    ReadDTCInformation_19_0A_Triger = TRUE;
  }
  /* ClearDiagnosticInformation */
  else if(@this == 6)
  {
    ClearDiagnosticInformation_14_Triger = TRUE;
  }
  /* None */
  else
  {
    /* Do nothing */
  }
  
}

/**************************************************************************************************/
/**
    \brief   sysvar::Test::Test
    \period  Event
    \author  Yueting.Ben
*/
/**************************************************************************************************/
on sysvar_update sysvar::Test::Test
{
  if(@this == 1)
  {
    TestTaskEnable = TRUE;
  }
  else
  {
    TestTaskEnable = FALSE;
  }
}