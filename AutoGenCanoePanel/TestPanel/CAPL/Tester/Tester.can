/*MMMMMMMMMMMMNNNNNMMMMMMMMMMMMMMMMMMMMMMMMMMMNNNNNMMMMMMMMMMMMMMMMMMMMMMMMMMMNNNNNNMMMMMMMMMMMMM*/
/*M+NMMMNdyso+////++oyhmNMMMMMMMMMMMMMMMNmhso++////+oshmNMMMMMMMMMMMMMMMNmhyo++////+osydNNNNMNNNM*/
/*M+NMMd///+osyyyyss+///+smNMMMMMMMMMNds+///osyyyyyso////sdNMMMMMMMMMNmy+///+osyyyyso+///ohNNNNNM*/
/*M+NNMdohmNNMNNNNNNNNdy+//odNMMMMNNh+//+ymNNNNNNNNNNNmy+//+hNNNNNNNdo//+sdNNNNNNNNNNNmho//+yNNNM*/
/*M+NNNNNNNmhysooosydNNNNh+//yNNNNms//+dNNNNdysooosydNNNNdo//omNNNNy//+hNNNNdysooooyhmNNNms//+dNM*/
/*M+NNNNNdo//////////+ymNNmo//smmdo//sNNNms///////////sdmmdo//+dmms//omNNNy+//////////odmmms//+dM*/
/*M+mNNNy//////////////+mNNm+///////oNNNd+//////////////////////////+mNNm+/////////////////////oM*/
/*M+mNNd////////////////sNNNmdddhhhhmNNm+////////////////hhhhhhhhhhhdNNNmhhhhhhhhhhhhhhhhhhhh///M*/
/*M+mNNd////////////////oNNNNNNNNNNNNNNm+////////////////dNNNNNNNNNNNNNNNNNNNNNNNNNNNNNNNNNNm+//M*/
/*M/hNNmo///////////////hNNNs///////yNNNy///////////////////////////////////////////////omNNh//+M*/
/*M/+dNNms////////////+hNNNy//+sss///hNNmy/////////////ssss+///sss+///ssss+////////////smNNd+//yM*/
/*M//+hmNNmyo+/////+shmNNms//+dNNNh+//ymNNmho+/////+ohmNNmy///hNNNd+//odNNmhs+//////oymNNmh+//ymM*/
/*Mh+//+ymNNNmmmdmmNNNmds///smNNNNNdo//+ydmNNNmmdmmmNNmdy+//odNNNNNms///sdmNNNmmdmmmNNNmy+//+hmNM*/
/*Mmmho///+syhdddddhyo+///sdmNNNNNNNmho///+syhdddddhys+///ohmNNNNNNNNds+//+oyhdddddhys+///ohmNNNM*/
/*Mmmmmdyo+///////////oshmmmNmmmmmmNNmmmhs+///////////+shmmNNNNNNNNNNNNmhso///////////+oydmNNmmmM*/
/*MmmmmmmmmmdhyyyyhddmmmmmmmmmmmmmmmmmmmmmmmddhyyyhddmmmmmmmmmmmmmmmmmmmmmmmddhyyyyhdmmmmmmmmmmmM*/
/*MMMMMMMMMMMMNNNNNMMMMMMMMMMMMMMMMMMMMMMMMMMMNNNNNMMMMMMMMMMMMMMMMMMMMMMMMMMMNNNNNNMMMMMMMMMMMMM*

  filename:     Tester.can
  
  description:  Brief: Tester
                Generation date: 30/12/2020 15:52:11
                DBC File: GWM_B02_CSA.dbc
                User Name: BenY
                
  ATTENTIONS:   This file code generated by Tool automatically, don't modify this 
                file manually.  
 ----------------------------------------------------------------------------- */
/* -----------------------------------------------------------------------------
  C O P Y R I G H T
 -------------------------------------------------------------------------------
  Copyright (c) 2019 by Yueting Ben. All rights reserved.
 -------------------------------------------------------------------------------
/**************************************************************************************************/
 variables
{
  message SBWM1 SBWM1_Frame;
  message BCM3 BCM3_Frame;
  message MCU_5 MCU_5_Frame;
  message TMCU6 TMCU6_Frame;
  message P2M3 P2M3_Frame;
  message R_PBox1 R_PBox1_Frame;
  message PEPS2 PEPS2_Frame;
  message HUT34 HUT34_Frame;
  message HUT_IP2 HUT_IP2_Frame;
  message ECM1 ECM1_Frame;
  message BCM1 BCM1_Frame;
  message ABS3 ABS3_Frame;
  msTimer SBWM1_Timer;
  msTimer BCM3_Timer;
  msTimer MCU_5_Timer;
  msTimer TMCU6_Timer;
  msTimer P2M3_Timer;
  msTimer R_PBox1_Timer;
  msTimer PEPS2_Timer;
  msTimer HUT34_Timer;
  msTimer HUT_IP2_Timer;
  msTimer ECM1_Timer;
  msTimer BCM1_Timer;
  msTimer ABS3_Timer;
  byte SBWM1_EnableFlag;
  byte SBWM1_MsgCounterEnable;
  byte SBWM1_CheckSumEnable;
  byte BCM3_EnableFlag;
  byte MCU_5_EnableFlag;
  byte TMCU6_EnableFlag;
  byte P2M3_EnableFlag;
  byte R_PBox1_EnableFlag;
  byte PEPS2_EnableFlag;
  byte HUT34_EnableFlag;
  byte HUT_IP2_EnableFlag;
  byte ECM1_EnableFlag;
  byte BCM1_EnableFlag;
  byte ABS3_EnableFlag;
}
on start
{
  setTimer(SBWM1_Timer, 0);
  setTimer(BCM3_Timer, 0);
  setTimer(MCU_5_Timer, 0);
  setTimer(TMCU6_Timer, 0);
  setTimer(P2M3_Timer, 0);
  setTimer(R_PBox1_Timer, 0);
  setTimer(PEPS2_Timer, 0);
  setTimer(HUT34_Timer, 0);
  setTimer(HUT_IP2_Timer, 0);
  setTimer(ECM1_Timer, 0);
  setTimer(BCM1_Timer, 0);
  setTimer(ABS3_Timer, 0);
  SBWM1_EnableFlag = @sysvar::MESSAGEFRAME::SBWM1MessageEnable & @sysvar::NODE::TesterEnableAll_Msg;
  SBWM1_MsgCounterEnable = @sysvar::MESSAGEFRAME::SBWM1MsgCounterEnable;
  SBWM1_CheckSumEnable = @sysvar::MESSAGEFRAME::SBWM1CheckSumEnable;
  BCM3_EnableFlag = @sysvar::MESSAGEFRAME::BCM3MessageEnable & @sysvar::NODE::TesterEnableAll_Msg;
  MCU_5_EnableFlag = @sysvar::MESSAGEFRAME::MCU_5MessageEnable & @sysvar::NODE::TesterEnableAll_Msg;
  TMCU6_EnableFlag = @sysvar::MESSAGEFRAME::TMCU6MessageEnable & @sysvar::NODE::TesterEnableAll_Msg;
  P2M3_EnableFlag = @sysvar::MESSAGEFRAME::P2M3MessageEnable & @sysvar::NODE::TesterEnableAll_Msg;
  R_PBox1_EnableFlag = @sysvar::MESSAGEFRAME::R_PBox1MessageEnable & @sysvar::NODE::TesterEnableAll_Msg;
  PEPS2_EnableFlag = @sysvar::MESSAGEFRAME::PEPS2MessageEnable & @sysvar::NODE::TesterEnableAll_Msg;
  HUT34_EnableFlag = @sysvar::MESSAGEFRAME::HUT34MessageEnable & @sysvar::NODE::TesterEnableAll_Msg;
  HUT_IP2_EnableFlag = @sysvar::MESSAGEFRAME::HUT_IP2MessageEnable & @sysvar::NODE::TesterEnableAll_Msg;
  ECM1_EnableFlag = @sysvar::MESSAGEFRAME::ECM1MessageEnable & @sysvar::NODE::TesterEnableAll_Msg;
  BCM1_EnableFlag = @sysvar::MESSAGEFRAME::BCM1MessageEnable & @sysvar::NODE::TesterEnableAll_Msg;
  ABS3_EnableFlag = @sysvar::MESSAGEFRAME::ABS3MessageEnable & @sysvar::NODE::TesterEnableAll_Msg;
}

/**************************************************************************************************/
/*
  brief:        Send SBWM1 in cycle
  
  author:       Generation tool
*/
/**************************************************************************************************/
 on Timer SBWM1_Timer
{
  byte SBWM1_MsgCounter;
  byte SBWM1_CheckSum;
  if(1 == SBWM1_EnableFlag)
  {
    output(SBWM1_Frame);
  }
  if(1 == SBWM1_MsgCounterEnable)
  {
    @sysvar::SIGNALINFO::RollingCounter_SBWM1Value = SBWM1_MsgCounter;
    SBWM1_Frame.RollingCounter_SBWM1 = @sysvar::SIGNALINFO::RollingCounter_SBWM1Value;
    SBWM1_MsgCounter = SBWM1_MsgCounter + 1;
  }
  SBWM1_Frame.E_ShiftFault = @sysvar::SIGNALINFO::E_ShiftFaultValue;
  SBWM1_Frame.DrvReqPark = @sysvar::SIGNALINFO::DrvReqParkValue;
  SBWM1_Frame.DrvReqUnlock = @sysvar::SIGNALINFO::DrvReqUnlockValue;
  SBWM1_Frame.ShftDispFlt = @sysvar::SIGNALINFO::ShftDispFltValue;
  SBWM1_Frame.ShftSensFlt = @sysvar::SIGNALINFO::ShftSensFltValue;
  SBWM1_Frame.DrvReqShftInv = @sysvar::SIGNALINFO::DrvReqShftInvValue;
  SBWM1_Frame.DRV_RQ_SHFT = @sysvar::SIGNALINFO::DRV_RQ_SHFTValue;
  /* Calculate checksum */ 
  SBWM1_CheckSum = SBWM1_Frame.byte(0)
                          ^ SBWM1_Frame.byte(1)
                          ^ SBWM1_Frame.byte(2)
                          ^ SBWM1_Frame.byte(3)
                          ^ SBWM1_Frame.byte(4)
                          ^ SBWM1_Frame.byte(5)
                          ^ SBWM1_Frame.byte(6);
  if(1 == SBWM1_CheckSumEnable)
  {
    @sysvar::SIGNALINFO::CheckSum_SBWM1Value = SBWM1_CheckSum;
    SBWM1_Frame.CheckSum_SBWM1 = @sysvar::SIGNALINFO::CheckSum_SBWM1Value;
  }
  setTimer(SBWM1_Timer, 50);
}

/**************************************************************************************************/
/*
  brief:        Send BCM3 in cycle
  
  author:       Generation tool
*/
/**************************************************************************************************/
 on Timer BCM3_Timer
{
  if(1 == BCM3_EnableFlag)
  {
    output(BCM3_Frame);
  }
  BCM3_Frame.PowerModeBackup = @sysvar::SIGNALINFO::PowerModeBackupValue;
  setTimer(BCM3_Timer, 50);
}

/**************************************************************************************************/
/*
  brief:        Send MCU_5 in cycle
  
  author:       Generation tool
*/
/**************************************************************************************************/
 on Timer MCU_5_Timer
{
  if(1 == MCU_5_EnableFlag)
  {
    output(MCU_5_Frame);
  }
  MCU_5_Frame.MCU_ActRotSpd = @sysvar::SIGNALINFO::MCU_ActRotSpdValue;
  setTimer(MCU_5_Timer, 10);
}

/**************************************************************************************************/
/*
  brief:        Send TMCU6 in cycle
  
  author:       Generation tool
*/
/**************************************************************************************************/
 on Timer TMCU6_Timer
{
  if(1 == TMCU6_EnableFlag)
  {
    output(TMCU6_Frame);
  }
  TMCU6_Frame.TMCU_ActPosRotSpd = @sysvar::SIGNALINFO::TMCU_ActPosRotSpdValue;
  setTimer(TMCU6_Timer, 10);
}

/**************************************************************************************************/
/*
  brief:        Send P2M3 in cycle
  
  author:       Generation tool
*/
/**************************************************************************************************/
 on Timer P2M3_Timer
{
  if(1 == P2M3_EnableFlag)
  {
    output(P2M3_Frame);
  }
  P2M3_Frame.P2M_ActSpd = @sysvar::SIGNALINFO::P2M_ActSpdValue;
  setTimer(P2M3_Timer, 10);
}

/**************************************************************************************************/
/*
  brief:        Send R_PBox1 in cycle
  
  author:       Generation tool
*/
/**************************************************************************************************/
 on Timer R_PBox1_Timer
{
  if(1 == R_PBox1_EnableFlag)
  {
    output(R_PBox1_Frame);
  }
  R_PBox1_Frame.PosnLmpOutpSts_R_Pbox = @sysvar::SIGNALINFO::PosnLmpOutpSts_R_PboxValue;
  setTimer(R_PBox1_Timer, 50);
}

/**************************************************************************************************/
/*
  brief:        Send PEPS2 in cycle
  
  author:       Generation tool
*/
/**************************************************************************************************/
 on Timer PEPS2_Timer
{
  if(1 == PEPS2_EnableFlag)
  {
    output(PEPS2_Frame);
  }
  PEPS2_Frame.SysPowerMod = @sysvar::SIGNALINFO::SysPowerModValue;
  setTimer(PEPS2_Timer, 50);
}

/**************************************************************************************************/
/*
  brief:        Send HUT34 in cycle
  
  author:       Generation tool
*/
/**************************************************************************************************/
 on Timer HUT34_Timer
{
  if(1 == HUT34_EnableFlag)
  {
    output(HUT34_Frame);
  }
  HUT34_Frame.Time_Day = @sysvar::SIGNALINFO::Time_DayValue;
  HUT34_Frame.Time_Month = @sysvar::SIGNALINFO::Time_MonthValue;
  HUT34_Frame.Time_Year_Right = @sysvar::SIGNALINFO::Time_Year_RightValue;
  HUT34_Frame.Time_Year_Left = @sysvar::SIGNALINFO::Time_Year_LeftValue;
  HUT34_Frame.Time_Minutes = @sysvar::SIGNALINFO::Time_MinutesValue;
  HUT34_Frame.Time_Hour = @sysvar::SIGNALINFO::Time_HourValue;
  setTimer(HUT34_Timer, 1000);
}

/**************************************************************************************************/
/*
  brief:        Send HUT_IP2 in cycle
  
  author:       Generation tool
*/
/**************************************************************************************************/
 on Timer HUT_IP2_Timer
{
  if(1 == HUT_IP2_EnableFlag)
  {
    output(HUT_IP2_Frame);
  }
  HUT_IP2_Frame.IP_VehTotDistanceValid = @sysvar::SIGNALINFO::IP_VehTotDistanceValidValue;
  HUT_IP2_Frame.IP_VehTotDistance = @sysvar::SIGNALINFO::IP_VehTotDistanceValue;
  setTimer(HUT_IP2_Timer, 50);
}

/**************************************************************************************************/
/*
  brief:        Send ECM1 in cycle
  
  author:       Generation tool
*/
/**************************************************************************************************/
 on Timer ECM1_Timer
{
  if(1 == ECM1_EnableFlag)
  {
    output(ECM1_Frame);
  }
  ECM1_Frame.EngSpdVldty = @sysvar::SIGNALINFO::EngSpdVldtyValue;
  ECM1_Frame.EngSpd = @sysvar::SIGNALINFO::EngSpdValue;
  setTimer(ECM1_Timer, 10);
}

/**************************************************************************************************/
/*
  brief:        Send BCM1 in cycle
  
  author:       Generation tool
*/
/**************************************************************************************************/
 on Timer BCM1_Timer
{
  if(1 == BCM1_EnableFlag)
  {
    output(BCM1_Frame);
  }
  BCM1_Frame.PosLmpOutputSts = @sysvar::SIGNALINFO::PosLmpOutputStsValue;
  BCM1_Frame.BackgroundLightLvl = @sysvar::SIGNALINFO::BackgroundLightLvlValue;
  setTimer(BCM1_Timer, 50);
}

/**************************************************************************************************/
/*
  brief:        Send ABS3 in cycle
  
  author:       Generation tool
*/
/**************************************************************************************************/
 on Timer ABS3_Timer
{
  if(1 == ABS3_EnableFlag)
  {
    output(ABS3_Frame);
  }
  ABS3_Frame.VehSpdVld = @sysvar::SIGNALINFO::VehSpdVldValue;
  ABS3_Frame.VehSpd = @sysvar::SIGNALINFO::VehSpdValue;
  setTimer(ABS3_Timer, 20);
}

/**************************************************************************************************/
/*
  brief:        Check the CheckBox Tester_EnableAll_Msg
  
  author:       Generation tool
*/
/**************************************************************************************************/
 on sysvar NODE::TesterEnableAll_Msg
{
  if(1 == @sysvar::NODE::TesterEnableAll_Msg)
  {
    @sysvar::NODE::TesterEnableAll_Msg = 1;
    @sysvar::NODE::TesterDisableAll_Msg = 0;
    @sysvar::MESSAGEFRAME::SBWM1MessageEnable = 1;
    SBWM1_EnableFlag = @sysvar::MESSAGEFRAME::SBWM1MessageEnable & @sysvar::NODE::TesterEnableAll_Msg;
    @sysvar::MESSAGEFRAME::BCM3MessageEnable = 1;
    BCM3_EnableFlag = @sysvar::MESSAGEFRAME::BCM3MessageEnable & @sysvar::NODE::TesterEnableAll_Msg;
    @sysvar::MESSAGEFRAME::MCU_5MessageEnable = 1;
    MCU_5_EnableFlag = @sysvar::MESSAGEFRAME::MCU_5MessageEnable & @sysvar::NODE::TesterEnableAll_Msg;
    @sysvar::MESSAGEFRAME::TMCU6MessageEnable = 1;
    TMCU6_EnableFlag = @sysvar::MESSAGEFRAME::TMCU6MessageEnable & @sysvar::NODE::TesterEnableAll_Msg;
    @sysvar::MESSAGEFRAME::P2M3MessageEnable = 1;
    P2M3_EnableFlag = @sysvar::MESSAGEFRAME::P2M3MessageEnable & @sysvar::NODE::TesterEnableAll_Msg;
    @sysvar::MESSAGEFRAME::R_PBox1MessageEnable = 1;
    R_PBox1_EnableFlag = @sysvar::MESSAGEFRAME::R_PBox1MessageEnable & @sysvar::NODE::TesterEnableAll_Msg;
    @sysvar::MESSAGEFRAME::PEPS2MessageEnable = 1;
    PEPS2_EnableFlag = @sysvar::MESSAGEFRAME::PEPS2MessageEnable & @sysvar::NODE::TesterEnableAll_Msg;
    @sysvar::MESSAGEFRAME::HUT34MessageEnable = 1;
    HUT34_EnableFlag = @sysvar::MESSAGEFRAME::HUT34MessageEnable & @sysvar::NODE::TesterEnableAll_Msg;
    @sysvar::MESSAGEFRAME::HUT_IP2MessageEnable = 1;
    HUT_IP2_EnableFlag = @sysvar::MESSAGEFRAME::HUT_IP2MessageEnable & @sysvar::NODE::TesterEnableAll_Msg;
    @sysvar::MESSAGEFRAME::ECM1MessageEnable = 1;
    ECM1_EnableFlag = @sysvar::MESSAGEFRAME::ECM1MessageEnable & @sysvar::NODE::TesterEnableAll_Msg;
    @sysvar::MESSAGEFRAME::BCM1MessageEnable = 1;
    BCM1_EnableFlag = @sysvar::MESSAGEFRAME::BCM1MessageEnable & @sysvar::NODE::TesterEnableAll_Msg;
    @sysvar::MESSAGEFRAME::ABS3MessageEnable = 1;
    ABS3_EnableFlag = @sysvar::MESSAGEFRAME::ABS3MessageEnable & @sysvar::NODE::TesterEnableAll_Msg;
  }
  else
  {
    @sysvar::NODE::TesterEnableAll_Msg = 0;
    @sysvar::NODE::TesterDisableAll_Msg = 1;
    @sysvar::MESSAGEFRAME::SBWM1MessageEnable = 0;
    SBWM1_EnableFlag = @sysvar::MESSAGEFRAME::SBWM1MessageEnable & @sysvar::NODE::TesterEnableAll_Msg;
    @sysvar::MESSAGEFRAME::BCM3MessageEnable = 0;
    BCM3_EnableFlag = @sysvar::MESSAGEFRAME::BCM3MessageEnable & @sysvar::NODE::TesterEnableAll_Msg;
    @sysvar::MESSAGEFRAME::MCU_5MessageEnable = 0;
    MCU_5_EnableFlag = @sysvar::MESSAGEFRAME::MCU_5MessageEnable & @sysvar::NODE::TesterEnableAll_Msg;
    @sysvar::MESSAGEFRAME::TMCU6MessageEnable = 0;
    TMCU6_EnableFlag = @sysvar::MESSAGEFRAME::TMCU6MessageEnable & @sysvar::NODE::TesterEnableAll_Msg;
    @sysvar::MESSAGEFRAME::P2M3MessageEnable = 0;
    P2M3_EnableFlag = @sysvar::MESSAGEFRAME::P2M3MessageEnable & @sysvar::NODE::TesterEnableAll_Msg;
    @sysvar::MESSAGEFRAME::R_PBox1MessageEnable = 0;
    R_PBox1_EnableFlag = @sysvar::MESSAGEFRAME::R_PBox1MessageEnable & @sysvar::NODE::TesterEnableAll_Msg;
    @sysvar::MESSAGEFRAME::PEPS2MessageEnable = 0;
    PEPS2_EnableFlag = @sysvar::MESSAGEFRAME::PEPS2MessageEnable & @sysvar::NODE::TesterEnableAll_Msg;
    @sysvar::MESSAGEFRAME::HUT34MessageEnable = 0;
    HUT34_EnableFlag = @sysvar::MESSAGEFRAME::HUT34MessageEnable & @sysvar::NODE::TesterEnableAll_Msg;
    @sysvar::MESSAGEFRAME::HUT_IP2MessageEnable = 0;
    HUT_IP2_EnableFlag = @sysvar::MESSAGEFRAME::HUT_IP2MessageEnable & @sysvar::NODE::TesterEnableAll_Msg;
    @sysvar::MESSAGEFRAME::ECM1MessageEnable = 0;
    ECM1_EnableFlag = @sysvar::MESSAGEFRAME::ECM1MessageEnable & @sysvar::NODE::TesterEnableAll_Msg;
    @sysvar::MESSAGEFRAME::BCM1MessageEnable = 0;
    BCM1_EnableFlag = @sysvar::MESSAGEFRAME::BCM1MessageEnable & @sysvar::NODE::TesterEnableAll_Msg;
    @sysvar::MESSAGEFRAME::ABS3MessageEnable = 0;
    ABS3_EnableFlag = @sysvar::MESSAGEFRAME::ABS3MessageEnable & @sysvar::NODE::TesterEnableAll_Msg;
  }
}

/**************************************************************************************************/
/*
  brief:        Check the CheckBox Tester_DisableAll_Msg
  
  author:       Generation tool
*/
/**************************************************************************************************/
 on sysvar NODE::TesterDisableAll_Msg
{
  if(1 == @sysvar::NODE::TesterDisableAll_Msg)
  {
    @sysvar::NODE::TesterEnableAll_Msg = 0;
    @sysvar::NODE::TesterDisableAll_Msg = 1;
    @sysvar::MESSAGEFRAME::SBWM1MessageEnable = 0;
    SBWM1_EnableFlag = @sysvar::MESSAGEFRAME::SBWM1MessageEnable & @sysvar::NODE::TesterEnableAll_Msg;
    @sysvar::MESSAGEFRAME::BCM3MessageEnable = 0;
    BCM3_EnableFlag = @sysvar::MESSAGEFRAME::BCM3MessageEnable & @sysvar::NODE::TesterEnableAll_Msg;
    @sysvar::MESSAGEFRAME::MCU_5MessageEnable = 0;
    MCU_5_EnableFlag = @sysvar::MESSAGEFRAME::MCU_5MessageEnable & @sysvar::NODE::TesterEnableAll_Msg;
    @sysvar::MESSAGEFRAME::TMCU6MessageEnable = 0;
    TMCU6_EnableFlag = @sysvar::MESSAGEFRAME::TMCU6MessageEnable & @sysvar::NODE::TesterEnableAll_Msg;
    @sysvar::MESSAGEFRAME::P2M3MessageEnable = 0;
    P2M3_EnableFlag = @sysvar::MESSAGEFRAME::P2M3MessageEnable & @sysvar::NODE::TesterEnableAll_Msg;
    @sysvar::MESSAGEFRAME::R_PBox1MessageEnable = 0;
    R_PBox1_EnableFlag = @sysvar::MESSAGEFRAME::R_PBox1MessageEnable & @sysvar::NODE::TesterEnableAll_Msg;
    @sysvar::MESSAGEFRAME::PEPS2MessageEnable = 0;
    PEPS2_EnableFlag = @sysvar::MESSAGEFRAME::PEPS2MessageEnable & @sysvar::NODE::TesterEnableAll_Msg;
    @sysvar::MESSAGEFRAME::HUT34MessageEnable = 0;
    HUT34_EnableFlag = @sysvar::MESSAGEFRAME::HUT34MessageEnable & @sysvar::NODE::TesterEnableAll_Msg;
    @sysvar::MESSAGEFRAME::HUT_IP2MessageEnable = 0;
    HUT_IP2_EnableFlag = @sysvar::MESSAGEFRAME::HUT_IP2MessageEnable & @sysvar::NODE::TesterEnableAll_Msg;
    @sysvar::MESSAGEFRAME::ECM1MessageEnable = 0;
    ECM1_EnableFlag = @sysvar::MESSAGEFRAME::ECM1MessageEnable & @sysvar::NODE::TesterEnableAll_Msg;
    @sysvar::MESSAGEFRAME::BCM1MessageEnable = 0;
    BCM1_EnableFlag = @sysvar::MESSAGEFRAME::BCM1MessageEnable & @sysvar::NODE::TesterEnableAll_Msg;
    @sysvar::MESSAGEFRAME::ABS3MessageEnable = 0;
    ABS3_EnableFlag = @sysvar::MESSAGEFRAME::ABS3MessageEnable & @sysvar::NODE::TesterEnableAll_Msg;
  }
  else
  {
    @sysvar::NODE::TesterEnableAll_Msg = 1;
    @sysvar::NODE::TesterDisableAll_Msg = 0;
    @sysvar::MESSAGEFRAME::SBWM1MessageEnable = 1;
    SBWM1_EnableFlag = @sysvar::MESSAGEFRAME::SBWM1MessageEnable & @sysvar::NODE::TesterEnableAll_Msg;
    @sysvar::MESSAGEFRAME::BCM3MessageEnable = 1;
    BCM3_EnableFlag = @sysvar::MESSAGEFRAME::BCM3MessageEnable & @sysvar::NODE::TesterEnableAll_Msg;
    @sysvar::MESSAGEFRAME::MCU_5MessageEnable = 1;
    MCU_5_EnableFlag = @sysvar::MESSAGEFRAME::MCU_5MessageEnable & @sysvar::NODE::TesterEnableAll_Msg;
    @sysvar::MESSAGEFRAME::TMCU6MessageEnable = 1;
    TMCU6_EnableFlag = @sysvar::MESSAGEFRAME::TMCU6MessageEnable & @sysvar::NODE::TesterEnableAll_Msg;
    @sysvar::MESSAGEFRAME::P2M3MessageEnable = 1;
    P2M3_EnableFlag = @sysvar::MESSAGEFRAME::P2M3MessageEnable & @sysvar::NODE::TesterEnableAll_Msg;
    @sysvar::MESSAGEFRAME::R_PBox1MessageEnable = 1;
    R_PBox1_EnableFlag = @sysvar::MESSAGEFRAME::R_PBox1MessageEnable & @sysvar::NODE::TesterEnableAll_Msg;
    @sysvar::MESSAGEFRAME::PEPS2MessageEnable = 1;
    PEPS2_EnableFlag = @sysvar::MESSAGEFRAME::PEPS2MessageEnable & @sysvar::NODE::TesterEnableAll_Msg;
    @sysvar::MESSAGEFRAME::HUT34MessageEnable = 1;
    HUT34_EnableFlag = @sysvar::MESSAGEFRAME::HUT34MessageEnable & @sysvar::NODE::TesterEnableAll_Msg;
    @sysvar::MESSAGEFRAME::HUT_IP2MessageEnable = 1;
    HUT_IP2_EnableFlag = @sysvar::MESSAGEFRAME::HUT_IP2MessageEnable & @sysvar::NODE::TesterEnableAll_Msg;
    @sysvar::MESSAGEFRAME::ECM1MessageEnable = 1;
    ECM1_EnableFlag = @sysvar::MESSAGEFRAME::ECM1MessageEnable & @sysvar::NODE::TesterEnableAll_Msg;
    @sysvar::MESSAGEFRAME::BCM1MessageEnable = 1;
    BCM1_EnableFlag = @sysvar::MESSAGEFRAME::BCM1MessageEnable & @sysvar::NODE::TesterEnableAll_Msg;
    @sysvar::MESSAGEFRAME::ABS3MessageEnable = 1;
    ABS3_EnableFlag = @sysvar::MESSAGEFRAME::ABS3MessageEnable & @sysvar::NODE::TesterEnableAll_Msg;
  }
}

/**************************************************************************************************/
/*
  brief:        Check the CheckBox SBWM1 MessageEnable
  
  author:       Generation tool
*/
/**************************************************************************************************/
 on sysvar MESSAGEFRAME::SBWM1MessageEnable
{
  SBWM1_EnableFlag = @sysvar::MESSAGEFRAME::SBWM1MessageEnable & @sysvar::NODE::TesterEnableAll_Msg;
}

/**************************************************************************************************/
/*
  brief:        Check the CheckBox SBWM1 MsgCounterEnable
  
  author:       Generation tool
*/
/**************************************************************************************************/
 on sysvar MESSAGEFRAME::SBWM1MsgCounterEnable
{
  SBWM1_MsgCounterEnable = @sysvar::MESSAGEFRAME::SBWM1MsgCounterEnable;
}

/**************************************************************************************************/
/*
  brief:        Check the CheckBox SBWM1 CheckSumEnable
  
  author:       Generation tool
*/
/**************************************************************************************************/
 on sysvar MESSAGEFRAME::SBWM1CheckSumEnable
{
  SBWM1_CheckSumEnable = @sysvar::MESSAGEFRAME::SBWM1CheckSumEnable;
}

/**************************************************************************************************/
/*
  brief:        Check the CheckBox BCM3 MessageEnable
  
  author:       Generation tool
*/
/**************************************************************************************************/
 on sysvar MESSAGEFRAME::BCM3MessageEnable
{
  BCM3_EnableFlag = @sysvar::MESSAGEFRAME::BCM3MessageEnable & @sysvar::NODE::TesterEnableAll_Msg;
}

/**************************************************************************************************/
/*
  brief:        Check the CheckBox MCU_5 MessageEnable
  
  author:       Generation tool
*/
/**************************************************************************************************/
 on sysvar MESSAGEFRAME::MCU_5MessageEnable
{
  MCU_5_EnableFlag = @sysvar::MESSAGEFRAME::MCU_5MessageEnable & @sysvar::NODE::TesterEnableAll_Msg;
}

/**************************************************************************************************/
/*
  brief:        Check the CheckBox TMCU6 MessageEnable
  
  author:       Generation tool
*/
/**************************************************************************************************/
 on sysvar MESSAGEFRAME::TMCU6MessageEnable
{
  TMCU6_EnableFlag = @sysvar::MESSAGEFRAME::TMCU6MessageEnable & @sysvar::NODE::TesterEnableAll_Msg;
}

/**************************************************************************************************/
/*
  brief:        Check the CheckBox P2M3 MessageEnable
  
  author:       Generation tool
*/
/**************************************************************************************************/
 on sysvar MESSAGEFRAME::P2M3MessageEnable
{
  P2M3_EnableFlag = @sysvar::MESSAGEFRAME::P2M3MessageEnable & @sysvar::NODE::TesterEnableAll_Msg;
}

/**************************************************************************************************/
/*
  brief:        Check the CheckBox R_PBox1 MessageEnable
  
  author:       Generation tool
*/
/**************************************************************************************************/
 on sysvar MESSAGEFRAME::R_PBox1MessageEnable
{
  R_PBox1_EnableFlag = @sysvar::MESSAGEFRAME::R_PBox1MessageEnable & @sysvar::NODE::TesterEnableAll_Msg;
}

/**************************************************************************************************/
/*
  brief:        Check the CheckBox PEPS2 MessageEnable
  
  author:       Generation tool
*/
/**************************************************************************************************/
 on sysvar MESSAGEFRAME::PEPS2MessageEnable
{
  PEPS2_EnableFlag = @sysvar::MESSAGEFRAME::PEPS2MessageEnable & @sysvar::NODE::TesterEnableAll_Msg;
}

/**************************************************************************************************/
/*
  brief:        Check the CheckBox HUT34 MessageEnable
  
  author:       Generation tool
*/
/**************************************************************************************************/
 on sysvar MESSAGEFRAME::HUT34MessageEnable
{
  HUT34_EnableFlag = @sysvar::MESSAGEFRAME::HUT34MessageEnable & @sysvar::NODE::TesterEnableAll_Msg;
}

/**************************************************************************************************/
/*
  brief:        Check the CheckBox HUT_IP2 MessageEnable
  
  author:       Generation tool
*/
/**************************************************************************************************/
 on sysvar MESSAGEFRAME::HUT_IP2MessageEnable
{
  HUT_IP2_EnableFlag = @sysvar::MESSAGEFRAME::HUT_IP2MessageEnable & @sysvar::NODE::TesterEnableAll_Msg;
}

/**************************************************************************************************/
/*
  brief:        Check the CheckBox ECM1 MessageEnable
  
  author:       Generation tool
*/
/**************************************************************************************************/
 on sysvar MESSAGEFRAME::ECM1MessageEnable
{
  ECM1_EnableFlag = @sysvar::MESSAGEFRAME::ECM1MessageEnable & @sysvar::NODE::TesterEnableAll_Msg;
}

/**************************************************************************************************/
/*
  brief:        Check the CheckBox BCM1 MessageEnable
  
  author:       Generation tool
*/
/**************************************************************************************************/
 on sysvar MESSAGEFRAME::BCM1MessageEnable
{
  BCM1_EnableFlag = @sysvar::MESSAGEFRAME::BCM1MessageEnable & @sysvar::NODE::TesterEnableAll_Msg;
}

/**************************************************************************************************/
/*
  brief:        Check the CheckBox ABS3 MessageEnable
  
  author:       Generation tool
*/
/**************************************************************************************************/
 on sysvar MESSAGEFRAME::ABS3MessageEnable
{
  ABS3_EnableFlag = @sysvar::MESSAGEFRAME::ABS3MessageEnable & @sysvar::NODE::TesterEnableAll_Msg;
}

