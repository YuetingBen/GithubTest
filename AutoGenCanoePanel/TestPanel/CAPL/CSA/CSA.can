/*MMMMMMMMMMMMNNNNNMMMMMMMMMMMMMMMMMMMMMMMMMMMNNNNNMMMMMMMMMMMMMMMMMMMMMMMMMMMNNNNNNMMMMMMMMMMMMM*/
/*M+NMMMNdyso+////++oyhmNMMMMMMMMMMMMMMMNmhso++////+oshmNMMMMMMMMMMMMMMMNmhyo++////+osydNNNNMNNNM*/
/*M+NMMd///+osyyyyss+///+smNMMMMMMMMMNds+///osyyyyyso////sdNMMMMMMMMMNmy+///+osyyyyso+///ohNNNNNM*/
/*M+NNMdohmNNMNNNNNNNNdy+//odNMMMMNNh+//+ymNNNNNNNNNNNmy+//+hNNNNNNNdo//+sdNNNNNNNNNNNmho//+yNNNM*/
/*M+NNNNNNNmhysooosydNNNNh+//yNNNNms//+dNNNNdysooosydNNNNdo//omNNNNy//+hNNNNdysooooyhmNNNms//+dNM*/
/*M+NNNNNdo//////////+ymNNmo//smmdo//sNNNms///////////sdmmdo//+dmms//omNNNy+//////////odmmms//+dM*/
/*M+mNNNy//////////////+mNNm+///////oNNNd+//////////////////////////+mNNm+/////////////////////oM*/
/*M+mNNd////////////////sNNNmdddhhhhmNNm+////////////////hhhhhhhhhhhdNNNmhhhhhhhhhhhhhhhhhhhh///M*/
/*M+mNNd////////////////oNNNNNNNNNNNNNNm+////////////////dNNNNNNNNNNNNNNNNNNNNNNNNNNNNNNNNNNm+//M*/
/*M/hNNmo///////////////hNNNs///////yNNNy///////////////////////////////////////////////omNNh//+M*/
/*M/+dNNms////////////+hNNNy//+sss///hNNmy/////////////ssss+///sss+///ssss+////////////smNNd+//yM*/
/*M//+hmNNmyo+/////+shmNNms//+dNNNh+//ymNNmho+/////+ohmNNmy///hNNNd+//odNNmhs+//////oymNNmh+//ymM*/
/*Mh+//+ymNNNmmmdmmNNNmds///smNNNNNdo//+ydmNNNmmdmmmNNmdy+//odNNNNNms///sdmNNNmmdmmmNNNmy+//+hmNM*/
/*Mmmho///+syhdddddhyo+///sdmNNNNNNNmho///+syhdddddhys+///ohmNNNNNNNNds+//+oyhdddddhys+///ohmNNNM*/
/*Mmmmmdyo+///////////oshmmmNmmmmmmNNmmmhs+///////////+shmmNNNNNNNNNNNNmhso///////////+oydmNNmmmM*/
/*MmmmmmmmmmdhyyyyhddmmmmmmmmmmmmmmmmmmmmmmmddhyyyhddmmmmmmmmmmmmmmmmmmmmmmmddhyyyyhdmmmmmmmmmmmM*/
/*MMMMMMMMMMMMNNNNNMMMMMMMMMMMMMMMMMMMMMMMMMMMNNNNNMMMMMMMMMMMMMMMMMMMMMMMMMMMNNNNNNMMMMMMMMMMMMM*

  filename:     CSA.can
  
  description:  Brief: CSA
                Generation date: 30/12/2020 15:52:11
                DBC File: GWM_B02_CSA.dbc
                User Name: BenY
                
  ATTENTIONS:   This file code generated by Tool automatically, don't modify this 
                file manually.  
 ----------------------------------------------------------------------------- */
/* -----------------------------------------------------------------------------
  C O P Y R I G H T
 -------------------------------------------------------------------------------
  Copyright (c) 2019 by Yueting Ben. All rights reserved.
 -------------------------------------------------------------------------------
/**************************************************************************************************/
 variables
{
  message CSA3 CSA3_Frame;
  message CSA2 CSA2_Frame;
  message CSA1 CSA1_Frame;
  msTimer CSA3_Timer;
  msTimer CSA2_Timer;
  msTimer CSA1_Timer;
  byte CSA3_EnableFlag;
  byte CSA3_MsgCounterEnable;
  byte CSA3_CheckSumEnable;
  byte CSA2_EnableFlag;
  byte CSA2_MsgCounterEnable;
  byte CSA2_CheckSumEnable;
  byte CSA1_EnableFlag;
  byte CSA1_MsgCounterEnable;
  byte CSA1_CheckSumEnable;
}
on start
{
  setTimer(CSA3_Timer, 0);
  setTimer(CSA2_Timer, 0);
  setTimer(CSA1_Timer, 0);
  CSA3_EnableFlag = @sysvar::MESSAGEFRAME::CSA3MessageEnable & @sysvar::NODE::CSAEnableAll_Msg;
  CSA3_MsgCounterEnable = @sysvar::MESSAGEFRAME::CSA3MsgCounterEnable;
  CSA3_CheckSumEnable = @sysvar::MESSAGEFRAME::CSA3CheckSumEnable;
  CSA2_EnableFlag = @sysvar::MESSAGEFRAME::CSA2MessageEnable & @sysvar::NODE::CSAEnableAll_Msg;
  CSA2_MsgCounterEnable = @sysvar::MESSAGEFRAME::CSA2MsgCounterEnable;
  CSA2_CheckSumEnable = @sysvar::MESSAGEFRAME::CSA2CheckSumEnable;
  CSA1_EnableFlag = @sysvar::MESSAGEFRAME::CSA1MessageEnable & @sysvar::NODE::CSAEnableAll_Msg;
  CSA1_MsgCounterEnable = @sysvar::MESSAGEFRAME::CSA1MsgCounterEnable;
  CSA1_CheckSumEnable = @sysvar::MESSAGEFRAME::CSA1CheckSumEnable;
}

/**************************************************************************************************/
/*
  brief:        Send CSA3 in cycle
  
  author:       Generation tool
*/
/**************************************************************************************************/
 on Timer CSA3_Timer
{
  byte CSA3_MsgCounter;
  byte CSA3_CheckSum;
  if(1 == CSA3_EnableFlag)
  {
    output(CSA3_Frame);
  }
  CSA3_Frame.WeChatVTSwt = @sysvar::SIGNALINFO::WeChatVTSwtValue;
  CSA3_Frame.CustomSwtSts_Mmed_CAN = @sysvar::SIGNALINFO::CustomSwtSts_Mmed_CANValue;
  CSA3_Frame.EnterSwtSts_Mmed_CAN = @sysvar::SIGNALINFO::EnterSwtSts_Mmed_CANValue;
  CSA3_Frame.VRSwtSts = @sysvar::SIGNALINFO::VRSwtStsValue;
  CSA3_Frame.SoundSourceModSwtSts = @sysvar::SIGNALINFO::SoundSourceModSwtStsValue;
  CSA3_Frame.SeekUpSwtSts = @sysvar::SIGNALINFO::SeekUpSwtStsValue;
  CSA3_Frame.SeekDwnSwtSts = @sysvar::SIGNALINFO::SeekDwnSwtStsValue;
  CSA3_Frame.PhoneSwtSts = @sysvar::SIGNALINFO::PhoneSwtStsValue;
  CSA3_Frame.PageUpSwtSts = @sysvar::SIGNALINFO::PageUpSwtStsValue;
  CSA3_Frame.PageRSwtSts = @sysvar::SIGNALINFO::PageRSwtStsValue;
  CSA3_Frame.PageLSwtSts = @sysvar::SIGNALINFO::PageLSwtStsValue;
  CSA3_Frame.PageDwnSwtSts = @sysvar::SIGNALINFO::PageDwnSwtStsValue;
  CSA3_Frame.EnterSwtSts = @sysvar::SIGNALINFO::EnterSwtStsValue;
  CSA3_Frame.AdjVolUpSwtSts = @sysvar::SIGNALINFO::AdjVolUpSwtStsValue;
  CSA3_Frame.AdjVolDwnSwtSts = @sysvar::SIGNALINFO::AdjVolDwnSwtStsValue;
  if(1 == CSA3_MsgCounterEnable)
  {
    @sysvar::SIGNALINFO::Rollingcounter_CSA3Value = CSA3_MsgCounter;
    CSA3_Frame.Rollingcounter_CSA3 = @sysvar::SIGNALINFO::Rollingcounter_CSA3Value;
    CSA3_MsgCounter = CSA3_MsgCounter + 1;
  }
  CSA3_Frame.CustomSwtSts = @sysvar::SIGNALINFO::CustomSwtStsValue;
  CSA3_Frame.MuteSwtSts = @sysvar::SIGNALINFO::MuteSwtStsValue;
  CSA3_Frame.HomeSwtSts = @sysvar::SIGNALINFO::HomeSwtStsValue;
  CSA3_Frame.MenuReturnSwtSts = @sysvar::SIGNALINFO::MenuReturnSwtStsValue;
  CSA3_Frame.SteerWheelHeatdSts = @sysvar::SIGNALINFO::SteerWheelHeatdStsValue;
  /* Calculate checksum */ 
  CSA3_CheckSum = CSA3_Frame.byte(0)
                          ^ CSA3_Frame.byte(1)
                          ^ CSA3_Frame.byte(2)
                          ^ CSA3_Frame.byte(3)
                          ^ CSA3_Frame.byte(4)
                          ^ CSA3_Frame.byte(5)
                          ^ CSA3_Frame.byte(6);
  if(1 == CSA3_CheckSumEnable)
  {
    @sysvar::SIGNALINFO::Checksum_CSA3Value = CSA3_CheckSum;
    CSA3_Frame.Checksum_CSA3 = @sysvar::SIGNALINFO::Checksum_CSA3Value;
  }
  setTimer(CSA3_Timer, 50);
}

/**************************************************************************************************/
/*
  brief:        Send CSA2 in cycle
  
  author:       Generation tool
*/
/**************************************************************************************************/
 on Timer CSA2_Timer
{
  byte CSA2_MsgCounter;
  byte CSA2_CheckSum;
  if(1 == CSA2_EnableFlag)
  {
    output(CSA2_Frame);
  }
  CSA2_Frame.CC_ACC_CancelSwt = @sysvar::SIGNALINFO::CC_ACC_CancelSwtValue;
  CSA2_Frame.CC_ACC_ON_OFFSwt = @sysvar::SIGNALINFO::CC_ACC_ON_OFFSwtValue;
  CSA2_Frame.ACCTimeGapSetSwt = @sysvar::SIGNALINFO::ACCTimeGapSetSwtValue;
  CSA2_Frame.HWA_OK_OFFSwt = @sysvar::SIGNALINFO::HWA_OK_OFFSwtValue;
  CSA2_Frame.CC_ACCSwtErr = @sysvar::SIGNALINFO::CC_ACCSwtErrValue;
  CSA2_Frame.CC_ACC_IncSetSpd_ResuSwt = @sysvar::SIGNALINFO::CC_ACC_IncSetSpd_ResuSwtValue;
  CSA2_Frame.CC_ACC_DecSetSpd_SetSwt = @sysvar::SIGNALINFO::CC_ACC_DecSetSpd_SetSwtValue;
  CSA2_Frame.CC_ACC_CRUISE_OFFSwt = @sysvar::SIGNALINFO::CC_ACC_CRUISE_OFFSwtValue;
  CSA2_Frame.CC_ACC_CANCEL_OFFSwt = @sysvar::SIGNALINFO::CC_ACC_CANCEL_OFFSwtValue;
  CSA2_Frame.ACC_TimeGap_IncSetSwt = @sysvar::SIGNALINFO::ACC_TimeGap_IncSetSwtValue;
  CSA2_Frame.ACC_TimeGap_DecSetSwt = @sysvar::SIGNALINFO::ACC_TimeGap_DecSetSwtValue;
  CSA2_Frame.ManualShiftReq = @sysvar::SIGNALINFO::ManualShiftReqValue;
  if(1 == CSA2_MsgCounterEnable)
  {
    @sysvar::SIGNALINFO::Rollingcounter_CSA2Value = CSA2_MsgCounter;
    CSA2_Frame.Rollingcounter_CSA2 = @sysvar::SIGNALINFO::Rollingcounter_CSA2Value;
    CSA2_MsgCounter = CSA2_MsgCounter + 1;
  }
  CSA2_Frame.SAS_Sts = @sysvar::SIGNALINFO::SAS_StsValue;
  CSA2_Frame.SteerWheelSpd = @sysvar::SIGNALINFO::SteerWheelSpdValue;
  CSA2_Frame.SteerWheelSpdSign = @sysvar::SIGNALINFO::SteerWheelSpdSignValue;
  CSA2_Frame.SteerWheelAng = @sysvar::SIGNALINFO::SteerWheelAngValue;
  CSA2_Frame.SteerWheelAngSign = @sysvar::SIGNALINFO::SteerWheelAngSignValue;
  /* Calculate checksum */ 
  CSA2_CheckSum = CSA2_Frame.byte(0)
                          ^ CSA2_Frame.byte(1)
                          ^ CSA2_Frame.byte(2)
                          ^ CSA2_Frame.byte(3)
                          ^ CSA2_Frame.byte(4)
                          ^ CSA2_Frame.byte(5)
                          ^ CSA2_Frame.byte(6);
  if(1 == CSA2_CheckSumEnable)
  {
    @sysvar::SIGNALINFO::Checksum_CSA2Value = CSA2_CheckSum;
    CSA2_Frame.Checksum_CSA2 = @sysvar::SIGNALINFO::Checksum_CSA2Value;
  }
  setTimer(CSA2_Timer, 10);
}

/**************************************************************************************************/
/*
  brief:        Send CSA1 in cycle
  
  author:       Generation tool
*/
/**************************************************************************************************/
 on Timer CSA1_Timer
{
  byte CSA1_MsgCounter;
  byte CSA1_CheckSum;
  if(1 == CSA1_EnableFlag)
  {
    output(CSA1_Frame);
  }
  CSA1_Frame.OverVehBeamSwtErrSts = @sysvar::SIGNALINFO::OverVehBeamSwtErrStsValue;
  CSA1_Frame.HiBeamSwtErrSts = @sysvar::SIGNALINFO::HiBeamSwtErrStsValue;
  CSA1_Frame.LowBeamSwtErrSts = @sysvar::SIGNALINFO::LowBeamSwtErrStsValue;
  CSA1_Frame.TurnLmpSwtErrSts = @sysvar::SIGNALINFO::TurnLmpSwtErrStsValue;
  if(1 == CSA1_MsgCounterEnable)
  {
    @sysvar::SIGNALINFO::Rollingcounter_CSA1Value = CSA1_MsgCounter;
    CSA1_Frame.Rollingcounter_CSA1 = @sysvar::SIGNALINFO::Rollingcounter_CSA1Value;
    CSA1_MsgCounter = CSA1_MsgCounter + 1;
  }
  CSA1_Frame.HornSwtSts = @sysvar::SIGNALINFO::HornSwtStsValue;
  CSA1_Frame.AutoLmpSwtSts = @sysvar::SIGNALINFO::AutoLmpSwtStsValue;
  CSA1_Frame.AutoHiLowBeamSwtSts = @sysvar::SIGNALINFO::AutoHiLowBeamSwtStsValue;
  CSA1_Frame.OverVehBeamSwtSts = @sysvar::SIGNALINFO::OverVehBeamSwtStsValue;
  CSA1_Frame.HiBeamSwtSts = @sysvar::SIGNALINFO::HiBeamSwtStsValue;
  CSA1_Frame.LowBeamSwtSts = @sysvar::SIGNALINFO::LowBeamSwtStsValue;
  CSA1_Frame.RearFogLmpSwtSts = @sysvar::SIGNALINFO::RearFogLmpSwtStsValue;
  CSA1_Frame.FrntFogLmpSwtSts = @sysvar::SIGNALINFO::FrntFogLmpSwtStsValue;
  CSA1_Frame.PosnLmpSwtSts = @sysvar::SIGNALINFO::PosnLmpSwtStsValue;
  CSA1_Frame.RTurnLmpSwtSts = @sysvar::SIGNALINFO::RTurnLmpSwtStsValue;
  CSA1_Frame.LTurnLmpSwtSts = @sysvar::SIGNALINFO::LTurnLmpSwtStsValue;
  CSA1_Frame.RLSSensitivityReq = @sysvar::SIGNALINFO::RLSSensitivityReqValue;
  CSA1_Frame.AutoHiLowBeamSwtErrSts = @sysvar::SIGNALINFO::AutoHiLowBeamSwtErrStsValue;
  CSA1_Frame.RearWiprSwtSts = @sysvar::SIGNALINFO::RearWiprSwtStsValue;
  CSA1_Frame.FrntWshrSwtSts = @sysvar::SIGNALINFO::FrntWshrSwtStsValue;
  CSA1_Frame.FrntWiprSwtSts = @sysvar::SIGNALINFO::FrntWiprSwtStsValue;
  /* Calculate checksum */ 
  CSA1_CheckSum = CSA1_Frame.byte(0)
                          ^ CSA1_Frame.byte(1)
                          ^ CSA1_Frame.byte(2)
                          ^ CSA1_Frame.byte(3)
                          ^ CSA1_Frame.byte(4)
                          ^ CSA1_Frame.byte(5)
                          ^ CSA1_Frame.byte(6);
  if(1 == CSA1_CheckSumEnable)
  {
    @sysvar::SIGNALINFO::Checksum_CSA1Value = CSA1_CheckSum;
    CSA1_Frame.Checksum_CSA1 = @sysvar::SIGNALINFO::Checksum_CSA1Value;
  }
  setTimer(CSA1_Timer, 20);
}

/**************************************************************************************************/
/*
  brief:        Check the CheckBox CSA_EnableAll_Msg
  
  author:       Generation tool
*/
/**************************************************************************************************/
 on sysvar NODE::CSAEnableAll_Msg
{
  if(1 == @sysvar::NODE::CSAEnableAll_Msg)
  {
    @sysvar::NODE::CSAEnableAll_Msg = 1;
    @sysvar::NODE::CSADisableAll_Msg = 0;
    @sysvar::MESSAGEFRAME::CSA3MessageEnable = 1;
    CSA3_EnableFlag = @sysvar::MESSAGEFRAME::CSA3MessageEnable & @sysvar::NODE::CSAEnableAll_Msg;
    @sysvar::MESSAGEFRAME::CSA2MessageEnable = 1;
    CSA2_EnableFlag = @sysvar::MESSAGEFRAME::CSA2MessageEnable & @sysvar::NODE::CSAEnableAll_Msg;
    @sysvar::MESSAGEFRAME::CSA1MessageEnable = 1;
    CSA1_EnableFlag = @sysvar::MESSAGEFRAME::CSA1MessageEnable & @sysvar::NODE::CSAEnableAll_Msg;
  }
  else
  {
    @sysvar::NODE::CSAEnableAll_Msg = 0;
    @sysvar::NODE::CSADisableAll_Msg = 1;
    @sysvar::MESSAGEFRAME::CSA3MessageEnable = 0;
    CSA3_EnableFlag = @sysvar::MESSAGEFRAME::CSA3MessageEnable & @sysvar::NODE::CSAEnableAll_Msg;
    @sysvar::MESSAGEFRAME::CSA2MessageEnable = 0;
    CSA2_EnableFlag = @sysvar::MESSAGEFRAME::CSA2MessageEnable & @sysvar::NODE::CSAEnableAll_Msg;
    @sysvar::MESSAGEFRAME::CSA1MessageEnable = 0;
    CSA1_EnableFlag = @sysvar::MESSAGEFRAME::CSA1MessageEnable & @sysvar::NODE::CSAEnableAll_Msg;
  }
}

/**************************************************************************************************/
/*
  brief:        Check the CheckBox CSA_DisableAll_Msg
  
  author:       Generation tool
*/
/**************************************************************************************************/
 on sysvar NODE::CSADisableAll_Msg
{
  if(1 == @sysvar::NODE::CSADisableAll_Msg)
  {
    @sysvar::NODE::CSAEnableAll_Msg = 0;
    @sysvar::NODE::CSADisableAll_Msg = 1;
    @sysvar::MESSAGEFRAME::CSA3MessageEnable = 0;
    CSA3_EnableFlag = @sysvar::MESSAGEFRAME::CSA3MessageEnable & @sysvar::NODE::CSAEnableAll_Msg;
    @sysvar::MESSAGEFRAME::CSA2MessageEnable = 0;
    CSA2_EnableFlag = @sysvar::MESSAGEFRAME::CSA2MessageEnable & @sysvar::NODE::CSAEnableAll_Msg;
    @sysvar::MESSAGEFRAME::CSA1MessageEnable = 0;
    CSA1_EnableFlag = @sysvar::MESSAGEFRAME::CSA1MessageEnable & @sysvar::NODE::CSAEnableAll_Msg;
  }
  else
  {
    @sysvar::NODE::CSAEnableAll_Msg = 1;
    @sysvar::NODE::CSADisableAll_Msg = 0;
    @sysvar::MESSAGEFRAME::CSA3MessageEnable = 1;
    CSA3_EnableFlag = @sysvar::MESSAGEFRAME::CSA3MessageEnable & @sysvar::NODE::CSAEnableAll_Msg;
    @sysvar::MESSAGEFRAME::CSA2MessageEnable = 1;
    CSA2_EnableFlag = @sysvar::MESSAGEFRAME::CSA2MessageEnable & @sysvar::NODE::CSAEnableAll_Msg;
    @sysvar::MESSAGEFRAME::CSA1MessageEnable = 1;
    CSA1_EnableFlag = @sysvar::MESSAGEFRAME::CSA1MessageEnable & @sysvar::NODE::CSAEnableAll_Msg;
  }
}

/**************************************************************************************************/
/*
  brief:        Check the CheckBox CSA3 MessageEnable
  
  author:       Generation tool
*/
/**************************************************************************************************/
 on sysvar MESSAGEFRAME::CSA3MessageEnable
{
  CSA3_EnableFlag = @sysvar::MESSAGEFRAME::CSA3MessageEnable & @sysvar::NODE::CSAEnableAll_Msg;
}

/**************************************************************************************************/
/*
  brief:        Check the CheckBox CSA3 MsgCounterEnable
  
  author:       Generation tool
*/
/**************************************************************************************************/
 on sysvar MESSAGEFRAME::CSA3MsgCounterEnable
{
  CSA3_MsgCounterEnable = @sysvar::MESSAGEFRAME::CSA3MsgCounterEnable;
}

/**************************************************************************************************/
/*
  brief:        Check the CheckBox CSA3 CheckSumEnable
  
  author:       Generation tool
*/
/**************************************************************************************************/
 on sysvar MESSAGEFRAME::CSA3CheckSumEnable
{
  CSA3_CheckSumEnable = @sysvar::MESSAGEFRAME::CSA3CheckSumEnable;
}

/**************************************************************************************************/
/*
  brief:        Check the CheckBox CSA2 MessageEnable
  
  author:       Generation tool
*/
/**************************************************************************************************/
 on sysvar MESSAGEFRAME::CSA2MessageEnable
{
  CSA2_EnableFlag = @sysvar::MESSAGEFRAME::CSA2MessageEnable & @sysvar::NODE::CSAEnableAll_Msg;
}

/**************************************************************************************************/
/*
  brief:        Check the CheckBox CSA2 MsgCounterEnable
  
  author:       Generation tool
*/
/**************************************************************************************************/
 on sysvar MESSAGEFRAME::CSA2MsgCounterEnable
{
  CSA2_MsgCounterEnable = @sysvar::MESSAGEFRAME::CSA2MsgCounterEnable;
}

/**************************************************************************************************/
/*
  brief:        Check the CheckBox CSA2 CheckSumEnable
  
  author:       Generation tool
*/
/**************************************************************************************************/
 on sysvar MESSAGEFRAME::CSA2CheckSumEnable
{
  CSA2_CheckSumEnable = @sysvar::MESSAGEFRAME::CSA2CheckSumEnable;
}

/**************************************************************************************************/
/*
  brief:        Check the CheckBox CSA1 MessageEnable
  
  author:       Generation tool
*/
/**************************************************************************************************/
 on sysvar MESSAGEFRAME::CSA1MessageEnable
{
  CSA1_EnableFlag = @sysvar::MESSAGEFRAME::CSA1MessageEnable & @sysvar::NODE::CSAEnableAll_Msg;
}

/**************************************************************************************************/
/*
  brief:        Check the CheckBox CSA1 MsgCounterEnable
  
  author:       Generation tool
*/
/**************************************************************************************************/
 on sysvar MESSAGEFRAME::CSA1MsgCounterEnable
{
  CSA1_MsgCounterEnable = @sysvar::MESSAGEFRAME::CSA1MsgCounterEnable;
}

/**************************************************************************************************/
/*
  brief:        Check the CheckBox CSA1 CheckSumEnable
  
  author:       Generation tool
*/
/**************************************************************************************************/
 on sysvar MESSAGEFRAME::CSA1CheckSumEnable
{
  CSA1_CheckSumEnable = @sysvar::MESSAGEFRAME::CSA1CheckSumEnable;
}

